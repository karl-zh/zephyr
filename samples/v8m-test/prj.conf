## CMakeLists.txt
```
include($ENV{ZEPHYR_BASE}/cmake/app/boilerplate.cmake NO_POLICY_SCOPE)
project(NONE)

target_sources(app PRIVATE src/main.c)
target_sources(app PRIVATE src/protocol.c)
target_sources(app PRIVATE src/pdump.c)
target_sources(app PRIVATE src/lqueue.c)
target_sources(app PRIVATE src/mqtt_pkt.c)
target_include_directories(app PRIVATE $ENV{ZEPHYR_BASE}/samples/v8m-test/ext/inc)
target_link_libraries(app $ENV{ZEPHYR_BASE}/samples/v8m-test/ext/veneers/s_veneers.o)
```

## prj.conf
```kconfig
#CONFIG_SCHED_MULTIQ=y
CONFIG_NETWORKING=y
CONFIG_TEST_RANDOM_GENERATOR=y

CONFIG_NET_TX_STACK_SIZE=2048
CONFIG_NET_RX_STACK_SIZE=2048

CONFIG_NET_PKT_RX_COUNT=10
CONFIG_NET_PKT_TX_COUNT=10
CONFIG_NET_BUF_RX_COUNT=20
CONFIG_NET_BUF_TX_COUNT=20
CONFIG_NET_MAX_CONTEXTS=10

CONFIG_NET_IPV4=y
CONFIG_NET_IPV6=n

CONFIG_NET_LOG=y
CONFIG_SYS_LOG_NET_LEVEL=1
CONFIG_SYS_LOG_SHOW_COLOR=y
CONFIG_INIT_STACKS=y

CONFIG_UART_MCUX=y
#CONFIG_UART_MCUX_1=y

CONFIG_UART_INTERRUPT_DRIVEN=y
CONFIG_HW_STACK_PROTECTION=y

CONFIG_MAIN_STACK_SIZE=4096
CONFIG_IDLE_STACK_SIZE=1024
CONFIG_ISR_STACK_SIZE=1024
CONFIG_NEWLIB_LIBC=y
CONFIG_GPIO=y

CONFIG_MBEDTLS_SSL_MAX_CONTENT_LEN=16384

# Enable MBEDTLS
CONFIG_MBEDTLS=y
CONFIG_MBEDTLS_BUILTIN=y
CONFIG_MBEDTLS_TEST=y
CONFIG_MBEDTLS_DEBUG=y
CONFIG_MBEDTLS_CFG_FILE="config-full-mqtt.h"
# nothing here
```

## src/main.c
```c
/*
 * Copyright (c) 2012-2014 Wind River Systems, Inc.
 *
 * SPDX-License-Identifier: Apache-2.0
 */

#include <zephyr.h>
#include <misc/printk.h>
#include <time.h>
#include <tfm_sst_veneers.h>
#include <tfm_led_veneers.h>
//#include <tfm_ss_core_test_veneers.h>
//#include <tfm_ss_core_test_2_veneers.h>
#include <wifi_esp8266.h>

#define CORE_TEST_ID_NS_THREAD          1001
#define CORE_TEST_ID_NS_SVC             1002
#define CORE_TEST_ID_CHECK_INIT         1003
#define CORE_TEST_ID_RECURSION          1004
#define CORE_TEST_ID_MEMORY_PERMISSIONS 1005
#define CORE_TEST_ID_MPU_ACCESS         1006
#define CORE_TEST_ID_BUFFER_CHECK       1007
#define CORE_TEST_ID_SS_TO_SS           1008
#define CORE_TEST_ID_SHARE_REDIRECTION  1009
#define CORE_TEST_ID_SS_TO_SS_BUFFER    1010
#define CORE_TEST_ID_TWO_SFN_ONE_SVC    1011
#define CORE_TEST_ID_PERIPHERAL_ACCESS  1012
#define CORE_TEST_ID_BLOCK              2001
#define CORE_TEST_RETURN_ERROR(x) return (((__LINE__) << 16) | x)
#define CORE_TEST_ERROR_GET_EXTRA(x) (x >> 16)
#define CORE_TEST_ERROR_GET_CODE(x) (x & 0xFFFF)

/* No idea. */
#define TFM_SERVICE_SPECIFIC_ERROR_MIN 1234

enum core_test_errno_t {
    CORE_TEST_ERRNO_SUCCESS = 0,
    CORE_TEST_ERRNO_SERVICE_NOT_INITED = TFM_SERVICE_SPECIFIC_ERROR_MIN,
    CORE_TEST_ERRNO_UNEXPECTED_CORE_BEHAVIOUR,
    CORE_TEST_ERRNO_SERVICE_RECURSION_NOT_REJECTED,
    CORE_TEST_ERRNO_INVALID_BUFFER,
    CORE_TEST_ERRNO_SLAVE_SERVICE_CALL_FAILURE,
    CORE_TEST_ERRNO_SLAVE_SERVICE_BUFFER_FAILURE,
    CORE_TEST_ERRNO_FIRST_CALL_FAILED,
    CORE_TEST_ERRNO_SECOND_CALL_FAILED,
    CORE_TEST_ERRNO_PERIPHERAL_ACCESS_FAILED,
    CORE_TEST_ERRNO_TEST_FAULT,
    CORE_TEST_ERRNO_INVALID_TEST_ID,
    /* Following entry is only to ensure the error code of int size */
    CORE_TEST_ERRNO_FORCE_INT_SIZE = INT_MAX
};

static char *error_to_string(const char *desc, int32_t err)
{
    static char info[80];

    sprintf(info, "%s. Error code: %d, extra data: %d",
        desc,
        CORE_TEST_ERROR_GET_CODE(err),
        CORE_TEST_ERROR_GET_EXTRA(err));
    return info;
}

#define TOSTRING(x) #x
#define CORE_TEST_DESCRIPTION(number, fn, description) \
    {fn, "TFM_CORE_TEST_"TOSTRING(number),\
     description, {0} }

enum test_status_t {
    TEST_PASSED = 0,  /*!< Test has passed */
    TEST_FAILED = 1,  /*!< Test has failed */
};

struct test_result_t {
    enum test_status_t val;  /*!< Test result \ref test_status_t */
    const char *info_msg;    /*!< Information message to show in case of
                              *   failure
                              */
    const char *filename;    /*!< Filename where the failure has occured */
    uint32_t    line;        /*!< Line where the failure has occured */
};

static void tfm_core_test_ns_thread(struct test_result_t *ret);
static void tfm_core_test_ns_svc(struct test_result_t *ret);
static void tfm_core_test_check_init(struct test_result_t *ret);
static void tfm_core_test_recursion(struct test_result_t *ret);
static void tfm_core_test_permissions(struct test_result_t *ret);
static void tfm_core_test_mpu_access(struct test_result_t *ret);
static void tfm_core_test_buffer_check(struct test_result_t *ret);
static void tfm_core_test_ss_to_ss(struct test_result_t *ret);
static void tfm_core_test_share_change(struct test_result_t *ret);
static void tfm_core_test_ss_to_ss_buffer(struct test_result_t *ret);
static void tfm_core_test_two_sfn_one_svc(struct test_result_t *ret);
static void tfm_core_test_peripheral_access(struct test_result_t *ret);

typedef void TEST_FUN(struct test_result_t *ret);

struct test_t {
	TEST_FUN * const test;
	const char *name;
	const char *desc;
	struct test_result_t ret;
};

enum tfm_svc_num {
    SVC_INVALID = 0,

/* SVC API for SST */
    SVC_TFM_SST_GET_HANDLE = 4,
    SVC_TFM_SST_CREATE,
    SVC_TFM_SST_GET_ATTRIBUTES,
    SVC_TFM_SST_READ,
    SVC_TFM_SST_WRITE,
    SVC_TFM_SST_DELETE,

    SVC_TFM_CORE_TEST,
    SVC_TFM_CORE_TEST_MULTIPLE_CALLS,
};

#define SVC(code) __asm__ volatile ("svc %0" : : "I" (code))

__attribute__ ((naked)) int32_t tfm_core_test_svc(void *fn_ptr, int32_t args[])
{
    SVC(SVC_TFM_CORE_TEST);
    __asm__ volatile ("BX LR");
}

__attribute__ ((naked)) int32_t tfm_core_test_multiple_calls_svc(void *fn_ptr,
                                                                 int32_t args[])
{
    SVC(SVC_TFM_CORE_TEST_MULTIPLE_CALLS);
    __asm__ volatile ("BX LR");
}
#ifdef CONFIG_BOARD_MPS2_AN521

int32_t args[4] = {0};

void tfm_core_test_ns_thread(struct test_result_t *ret)
{
   int32_t err = tfm_core_test_sfn(CORE_TEST_ID_NS_THREAD, 0, 0, 0);

    printk("%s - test started\n", __func__);
    if (err == TFM_SUCCESS) {
        printk("%s - TFM Core allowed service to run.", __func__);
        return;
    }

    printk("%s - test passed\n", __func__);
    ret->val = TEST_PASSED;
}

void tfm_core_test_ns_svc(struct test_result_t *ret)
{
    args[0] = CORE_TEST_ID_NS_SVC;
    int32_t err = tfm_core_test_svc(tfm_core_test_sfn, args);

    printk("%s - test started\n", __func__);
    if (err != TFM_SUCCESS) {
        printk("%s - Service failed to run.", __func__);
        return;
    }

    printk("%s - test passed\n", __func__);
    ret->val = TEST_PASSED;
}

void tfm_core_test_check_init(struct test_result_t *ret)
{
    int32_t err;

    printk("%s - test started\n", __func__);
    err = tfm_core_test_svc(tfm_core_test_sfn_init_success, args);

    if ((err != TFM_SUCCESS) && (err < TFM_SERVICE_SPECIFIC_ERROR_MIN)) {
        printk("%s - TFM Core returned error.", __func__);
        return;
    }

    if (err != CORE_TEST_ERRNO_SUCCESS) {
        printk("%s- Failed to initialise test service.", __func__);
        return;
    }

    printk("%s - test passed\n", __func__);
    ret->val = TEST_PASSED;
}

static void tfm_core_test_recursion(struct test_result_t *ret)
{
    int32_t err;

    printk("%s - test started\n", __func__);
    /* Initialize depth argument to 0 */
    args[0] = 0;
    err = tfm_core_test_svc(tfm_core_test_sfn_direct_recursion, args);

    if (err != TFM_SUCCESS && err < 256) {
        printk("%s - TFM Core returned error.", __func__);
        return;
    }

    switch (err) {
    case CORE_TEST_ERRNO_SUCCESS:
        ret->val = TEST_PASSED;
	printk("%s - test passed\n", __func__);
        return;
    case CORE_TEST_ERRNO_SERVICE_RECURSION_NOT_REJECTED:
        printk("%s - TF-M Core failed to reject recursive service call.", __func__);
        return;
    default:
        printk("%s - Unexpected return value received.", __func__);
        return;
    }
}

static void tfm_core_test_mpu_access(struct test_result_t *ret)
{
    int32_t err;

    printk("%s - test started\n", __func__);
    int32_t args[] = {
        CORE_TEST_ID_MPU_ACCESS,
        (int32_t)args,
        /* Make sure the pointer in code segment is word-aligned */
        (int32_t)tfm_core_test_mpu_access & (~(0x3)),
        (int32_t)args};

    err = tfm_core_test_svc(tfm_core_test_sfn, args);

    if (err != TFM_SUCCESS && err < TFM_SERVICE_SPECIFIC_ERROR_MIN) {
        printk("%s - TFM Core returned error.", __func__);
        return;
    }

    if (err != CORE_TEST_ERRNO_SUCCESS) {
        char *info = error_to_string(
            "Service memory accesses configured incorrectly.", err);
        printk("%s - %s\n", __func__, info);
        return;
    }

    printk("%s - test passed\n", __func__);
    ret->val = TEST_PASSED;
}

static void tfm_core_test_permissions(struct test_result_t *ret)
{
    int32_t err;

    printk("%s - test started\n", __func__);
    int32_t args[] = {
        CORE_TEST_ID_MEMORY_PERMISSIONS,
        (int32_t)args,
        /* Make sure the pointer in code segment is word-aligned */
        (int32_t)tfm_core_test_mpu_access & (~(0x3)),
        (int32_t)args};

    err = tfm_core_test_svc(tfm_core_test_sfn, args);

    if (err != TFM_SUCCESS && err < TFM_SERVICE_SPECIFIC_ERROR_MIN) {
        printk("%s - TFM Core returned error.", __func__);
        return;
    }

    if (err != CORE_TEST_ERRNO_SUCCESS) {
        char *info = error_to_string(
            "Service memory accesses configured incorrectly.", err);
        printk("%s - %s\n", __func__, info);
        return;
    }

    printk("%s - test passed\n", __func__);
    ret->val = TEST_PASSED;
}

static void tfm_core_test_buffer_check(struct test_result_t *ret)
{
    int32_t res, i;

    uint32_t inbuf[] = {1, 2, 3, 4, 0xAAAFFF, 0xFFFFFFFF};
    uint32_t outbuf[16] = {0};
    int32_t result;
    int32_t args[] = {(int32_t)&result, (int32_t)inbuf,
                  (int32_t)outbuf, (int32_t)sizeof(inbuf) >> 2};

    printk("%s - test started\n", __func__);
    res = tfm_core_test_svc(tfm_core_test_2_sfn_invert, args);
    if ((res != TFM_SUCCESS) && (res < TFM_SERVICE_SPECIFIC_ERROR_MIN)) {
        printk("%s - Call to secure service should be successful.", __func__);
        return;
    }
    if ((result == 0) && (res == TFM_SUCCESS)) {
        for (i = 0; i < sizeof(inbuf) >> 2; i++) {
            if (outbuf[i] != ~inbuf[i]) {
                printk("%s - Secure function failed to modify buffer.", __func__);
                return;
            }
        }
        for (; i < sizeof(outbuf) >> 2; i++) {
            if (outbuf[i] != 0) {
                printk("%s - Secure function buffer access overflow.", __func__);
                return;
            }
        }
    } else {
        printk("%s - Secure service returned error.", __func__);
        return;
    }

    printk("%s - test passed\n", __func__);
    ret->val = TEST_PASSED;
}

static void tfm_core_test_ss_to_ss(struct test_result_t *ret)
{
    int32_t err;

    printk("%s - test started\n", __func__);
    args[0] = CORE_TEST_ID_SS_TO_SS;
    err = tfm_core_test_svc(tfm_core_test_sfn, args);

    if (err != TFM_SUCCESS && err < TFM_SERVICE_SPECIFIC_ERROR_MIN) {
        printk("%s - Call to secure service should be successful.", __func__);
        return;
    }

    if (err != CORE_TEST_ERRNO_SUCCESS) {
        printk("%s - The internal service call failed.", __func__);
        return;
    }

    printk("%s - test passed\n", __func__);
    ret->val = TEST_PASSED;
}

static void tfm_core_test_share_change(struct test_result_t *ret)
{
    int32_t err;

    printk("%s - test started\n", __func__);
    args[0] = CORE_TEST_ID_SHARE_REDIRECTION;
    err = tfm_core_test_svc(tfm_core_test_sfn, args);

    if ((err != TFM_SUCCESS) && (err < TFM_SERVICE_SPECIFIC_ERROR_MIN)) {
        printk("%s - TFM Core returned error.", __func__);
        return;
    }

    if (err != CORE_TEST_ERRNO_SUCCESS) {
        printk("%s - Failed to redirect share region in service.", __func__);
        return;
    }

    printk("%s - test passed\n", __func__);
    ret->val = TEST_PASSED;
}

static void tfm_core_test_ss_to_ss_buffer(struct test_result_t *ret)
{
    int32_t res, i;

    uint32_t inbuf[] = {1, 2, 3, 4, 0xAAAFFF, 0xFFFFFFFF};
    uint32_t outbuf[16] = {0};
    int32_t args[] = {CORE_TEST_ID_SS_TO_SS_BUFFER, (int32_t)inbuf,
                  (int32_t)outbuf, (int32_t)sizeof(inbuf) >> 2};

    printk("%s - test started\n", __func__);
    res = tfm_core_test_svc(tfm_core_test_sfn, args);
    if ((res != TFM_SUCCESS) && (res < TFM_SERVICE_SPECIFIC_ERROR_MIN)) {
        printk("%s - Call to secure service should be successful.", __func__);
        return;
    }
    switch (res) {
    case TFM_SUCCESS:
        for (i = 0; i < sizeof(inbuf) >> 2; i++) {
            if (outbuf[i] != ~inbuf[i]) {
                printk("%s - Secure function failed to modify buffer.", __func__);
                return;
            }
        }
        for (; i < sizeof(outbuf) >> 2; i++) {
            if (outbuf[i] != 0) {
                printk("%s - Secure function buffer access overflow.", __func__);
                return;
            }
        }
	printk("%s - test passed\n", __func__);
        ret->val = TEST_PASSED;
        return;
    case CORE_TEST_ERRNO_INVALID_BUFFER:
        printk("%s - NS buffer rejected by TF-M core.", __func__);
        return;
    case CORE_TEST_ERRNO_SLAVE_SERVICE_CALL_FAILURE:
        printk("%s - Slave service call failed.", __func__);
        return;
    case CORE_TEST_ERRNO_SLAVE_SERVICE_BUFFER_FAILURE:
        printk("%s - Slave secure function failed to modify buffer.", __func__);
        return;
    default:
        printk("%s - Secure service returned error.", __func__);
        return;
    }
}

static void tfm_core_test_two_sfn_one_svc(struct test_result_t *ret)
{
    int32_t err;

    printk("%s - test started\n", __func__);
    args[0] = CORE_TEST_ID_TWO_SFN_ONE_SVC;
    err = tfm_core_test_multiple_calls_svc(tfm_core_test_sfn, args);

    if ((err != TFM_SUCCESS) && (err < TFM_SERVICE_SPECIFIC_ERROR_MIN)) {
        printk("%s - TFM Core returned error.", __func__);
        return;
    }

    switch (err) {
    case TFM_SUCCESS:
        ret->val = TEST_PASSED;
	printk("%s - test passed\n", __func__);
        return;
    case CORE_TEST_ERRNO_FIRST_CALL_FAILED:
        printk("%s - First call failed.", __func__);
        return;
    case CORE_TEST_ERRNO_SECOND_CALL_FAILED:
        printk("%s - Second call failed.", __func__);
        return;
    default:
        printk("%s - Secure service returned unknown error.", __func__);
        return;
    }
}

static void tfm_core_test_peripheral_access(struct test_result_t *ret)
{
    args[0] = CORE_TEST_ID_PERIPHERAL_ACCESS;

    int32_t err = tfm_core_test_svc(tfm_core_test_sfn, args);

    printk("%s - test started\n", __func__);
    if ((err != TFM_SUCCESS) && (err < TFM_SERVICE_SPECIFIC_ERROR_MIN)) {
        printk("%s - TFM Core returned error.", __func__);
        return;
    }

    switch (err) {
    case CORE_TEST_ERRNO_SUCCESS:
        ret->val = TEST_PASSED;
	printk("%s - test passed\n", __func__);
        return;
    case CORE_TEST_ERRNO_PERIPHERAL_ACCESS_FAILED:
        printk("%s - Service peripheral access failed.", __func__);
        return;
    default:
        printk("%s - Unexpected return value received.", __func__);
        return;
    }
}

#define SST_ASSET_ID_X509_CERT_LARGE 10
#define INVALID_ASSET_ID           0xFFFF
static struct test_result_t transient_result;

static void tfm_sst_test_1001(void)
{
    const uint16_t asset_uuid = SST_ASSET_ID_X509_CERT_LARGE;
    enum tfm_sst_err_t err;
    uint32_t hdl;
    struct test_result_t *ret = &transient_result;
    uint32_t args[4] = {0};

    printk("%s - test started\n", __func__);
    /* Checks write permissions in create function */
    args[0] = 11;
    args[1] = asset_uuid;
    err = tfm_core_test_svc(tfm_sst_veneer_create, args);
    if (err != TFM_SST_ERR_SUCCESS) {
        printk("%s - %d: Create should not fail for Thread_C", __func__, err);
        return;
    }

    args[0] = 11;
    args[1] = asset_uuid;
    args[2] = (uint32_t)&hdl;
    err = tfm_core_test_svc(tfm_sst_veneer_get_handle, args);
    if (err != TFM_SST_ERR_SUCCESS) {
        printk("%s - Get handle should return a valid asset handle\n", __func__);
        return;
    }

    /* Calls create with invalid asset ID */
    args[0] = 11;
    args[1] = INVALID_ASSET_ID;
    err = tfm_core_test_svc(tfm_sst_veneer_create, args);
    if (err != TFM_SST_ERR_ASSET_NOT_FOUND) {
        printk("%s - Create should fail for invalid ASSET ID\n", __func__);
        return;
    }

    /* Calls delete asset to clean up SST area for next test */
    args[0] = 11;
    args[1] = hdl;
    err = tfm_core_test_svc(tfm_sst_veneer_delete, args);
    if (err != TFM_SST_ERR_SUCCESS) {
        printk("%s - The delete action should work correctly\n", __func__);
        return;
    }

    printk("%s - test passed\n", __func__);
    ret->val = TEST_PASSED;
}

static void tfm_sst_test_1002(void)
{
    struct test_result_t *ret = &transient_result;
    enum tfm_sst_err_t err;
    const uint16_t asset_uuid = SST_ASSET_ID_X509_CERT_LARGE;
    /* Calls create with invalid application ID */
    printk("%s - test started\n", __func__);
    args[0] = 10;
    args[1] = asset_uuid;
    err = tfm_core_test_svc(tfm_sst_veneer_create, args);
    if (err != TFM_SST_ERR_ASSET_NOT_FOUND) {
        printk("%s - Create should fail for thread without write permissions", __func__);
	return;
    }

    ret->val = TEST_PASSED;
    printk("%s - test passed\n", __func__);
}
#endif

#include <uart.h>
#include "net/wifi_mgmt.h"

static struct device *uart0_dev;
static struct device *uart1_dev;
static struct device *esp8266_dev;
static char rx_buf0[128];
static char rx_buf1[128];

#define AUDIENCE "our-chassis-213317"
//#define AUDIENCE "macro-precinct-211108"
char jwt_buffer[512];

void main(void)
{
#if defined CONFIG_BOARD_MPS2_AN521
	struct test_result_t foo;

	while (1) {

		printk("=============================================================\n");
		/* core tests */
		tfm_core_test_ns_thread(&foo);
		k_sleep(K_MSEC(1000));
		tfm_core_test_ns_svc(&foo);
		k_sleep(K_MSEC(1000));
		tfm_core_test_check_init(&foo);
		k_sleep(K_MSEC(1000));
		tfm_core_test_recursion(&foo);
		k_sleep(K_MSEC(1000));
		tfm_core_test_permissions(&foo);
		k_sleep(K_MSEC(1000));
		tfm_core_test_mpu_access(&foo);
		k_sleep(K_MSEC(1000));
		tfm_core_test_buffer_check(&foo);
		k_sleep(K_MSEC(1000));
		tfm_core_test_ss_to_ss(&foo);
		k_sleep(K_MSEC(1000));
		tfm_core_test_share_change(&foo);
		k_sleep(K_MSEC(1000));
		tfm_core_test_ss_to_ss_buffer(&foo);
		k_sleep(K_MSEC(1000));
		tfm_core_test_two_sfn_one_svc(&foo);
		k_sleep(K_MSEC(1000));
		tfm_core_test_peripheral_access(&foo);
		k_sleep(K_MSEC(1000));

		/* sst tests */
		tfm_sst_test_1001();
		k_sleep(K_MSEC(1000));
		tfm_sst_test_1002();
		k_sleep(K_MSEC(1000));
	}
#elif defined CONFIG_BOARD_MUSCA_A
    char counter = 0;
    struct net_wifi_mgmt_offload * esp8266_api;
    struct esp8266_data * esp8266_driver_data;
    struct wifi_connect_req_params esp8266_params;
    struct net_if iface;
	struct zsock_addrinfo *haddr;

    uart0_dev = device_get_binding("UART_0");
    esp8266_dev = device_get_binding("ESP8266");
      if (!(esp8266_dev && uart0_dev)) {
        printk("problem with device\n");
		return;
	}
    uart_irq_rx_enable(uart0_dev);

//    esp8266_params.ssid= "iot-test";
    esp8266_params.ssid= "iot-360";
    esp8266_params.ssid_length = strlen(esp8266_params.ssid);
    esp8266_params.psk = "shuo1988";
    esp8266_params.psk_length = strlen(esp8266_params.psk);
    esp8266_params.security = WIFI_SECURITY_TYPE_PSK;
    esp8266_api = (struct net_wifi_mgmt_offload *)esp8266_dev->driver_api;
    esp8266_driver_data = (struct esp8266_data *)esp8266_dev->driver_data;
    esp8266_api->iface_api.init(&iface);
    esp8266_api->connect(esp8266_dev, &esp8266_params);

    while(!esp8266_driver_data->transparent)
        k_sleep(K_MSEC(1000));

   uint32_t a = k_cycle_get_32();
   for (int i = 0; i < 10000; i++)
           __asm__ volatile("nop" : : : "memory");
   uint32_t b = k_cycle_get_32();
   printk("time %ld\n", b - a);

   tls_client("mqtt.googleapis.com", haddr, 8883);

#if 1
      a = b;
      struct tfm_sst_jwt_t jwt_cmd;
      time_t now = k_time(NULL);
      enum psa_sst_err_t err;
      uint32_t args[4] = {0};
      args[0] = 10;
      args[1] = 0;
//   while(1){
      jwt_cmd.buffer = jwt_buffer;
      jwt_cmd.buffer_size = (sizeof(jwt_buffer));
      jwt_cmd.iat = now - 2620802 - 86400;// + 600;//414;
      jwt_cmd.exp = jwt_cmd.iat + 60 * 60;
      jwt_cmd.aud = AUDIENCE;//"simple-demo";
      jwt_cmd.aud_len = strlen(jwt_cmd.aud);
      args[2] = 0;
      args[3] = &jwt_cmd;
      err = tfm_core_test_svc(tfm_veneer_jwt_sign, args);
      b = k_cycle_get_32();
      printk("result: %d, %x %x time %d\n", err, jwt_buffer[0], jwt_buffer[1], jwt_cmd.iat);
      if (err == 0) {
              printk("token: %s\n\n", jwt_buffer);
      }
   now += 100;
       printk("After the token: %ld ticks\n", b - a);
#endif

#if 0
   /* After setting the time, spin periodically, and make sure
    * the system clock keeps up reasonably.
    */
   for (int count = 0; count < 3; count++) {
       time_t now;
       struct tm tm;
       uint32_t c1, c2, c3;
       c1 = k_cycle_get_32();
       now = k_time(NULL);
       c2 = k_cycle_get_32();
       gmtime_r(&now, &tm);
       c3 = k_cycle_get_32();
       printk("time %d-%d-%d %d:%d:%d",
               tm.tm_year + 1900,
               tm.tm_mon + 1,
               tm.tm_mday,
               tm.tm_hour,
               tm.tm_min,
               tm.tm_sec);
       printk("time k_time(): %lu", c2 - c1);
       printk("time gmtime_r(): %lu", c3 - c2);
       k_sleep(990);
   }
#endif

    mqtt_startup();
   while (1) {
    tfm_core_test_svc(tfm_led_veneer_toggle, args);
    k_sleep(K_MSEC(1000));
   }
   /*
   if (err != TFM_SST_ERR_SUCCESS) {
           printk("Sign didn't work");
   }
   */

	while (1) {
		printk("========V2M Musca A1========\n");
		printk("Print Counter : 0x%02x\n", counter++);
		k_sleep(K_MSEC(1000));
	}
#endif
}
```

## src/lqueue.c
```c
#include "lqueue.h"
#include <stdlib.h>
#include <time.h>

#include <wifi_esp8266.h>
#include <cmsis_gcc.h>

void initial_queue(PQUEUE Q,int queue_maxsize)
{
	Q->front = Q->rear = 0;
	Q->pBase = (queue_element_type *)rx_buf;
    Q->QueueMaxsize = queue_maxsize;
}

bool en_queue(PQUEUE Q, queue_element_type val)
{
	if(full_queue(Q))
		return false;
	else
	{
		Q->pBase[Q->rear]=val;
		Q->rear=(Q->rear+1)%Q->QueueMaxsize;
 
		return true;
	}
}

bool de_queue(PQUEUE Q, queue_element_type *val)
{
    int key;
	if(empty_queue(Q))
	{
		return false;
	}
	else
	{
		key = irq_lock();
//        __disable_irq();
        *val=Q->pBase[Q->front];
        Q->front=(Q->front+1)%Q->QueueMaxsize;
//        __enable_irq();
		irq_unlock(key);

		return true;  
	}
}

bool empty_queue(PQUEUE Q)
{
	if(Q->front==Q->rear)
		return true;
	else
		return false;
}

bool full_queue(PQUEUE Q)
{
	if(Q->front==(Q->rear+1)%Q->QueueMaxsize)
		return true;
	else
		return false;
}
```

## src/lqueue.h
```c
#ifndef __LQUEUE_H_  
#define __LQUEUE_H_  

typedef  char queue_element_type;
 
#ifndef __cplusplus
#define bool   _Bool
#define true   1
#define false  0
#endif

typedef struct queue   
{  
	queue_element_type *pBase;
	int front;
	int rear;
	int QueueMaxsize;
}QUEUE,*PQUEUE;  
 
void initial_queue(PQUEUE Q,int queue_maxsize);   
bool full_queue(PQUEUE Q);  
bool empty_queue(PQUEUE Q);  
bool en_queue(PQUEUE Q, queue_element_type val);  
bool de_queue(PQUEUE Q, queue_element_type *val);  
 
#endif
```

## src/protocol.c
```c
/* Protocol implementation. */
/*
 * Copyright (c) 2018 Linaro Ltd
 *
 * SPDX-License-Identifier: Apache-2.0
 */

#define SYS_LOG_LEVEL SYS_LOG_LEVEL_DEBUG

#include "protocol.h"

#include <zephyr.h>
#include <logging/sys_log.h>
#include <string.h>
#include <jwt.h>

#include "mqtt.h"
#include "pdump.h"
#include <uart.h>

#include <mbedtls/platform.h>
#include <mbedtls/net.h>
#include <mbedtls/ssl.h>
#include <mbedtls/entropy.h>
#include <mbedtls/ctr_drbg.h>

#include <mbedtls/debug.h>
#include <wifi_esp8266.h>
#include "lqueue.h"
#include <tfm_led_veneers.h>

#ifdef CONFIG_STDOUT_CONSOLE
# include <stdio.h>
# define PRINT printf
#else
# define PRINT printk
#endif

QUEUE tcp_q;
/*
 * TODO: Properly export these.
 */
time_t k_time(time_t *ptr);

/*
 * mbed TLS has its own "memory buffer alloc" heap, but it needs some
 * data.  This size can be tuned.
 */
#ifdef MBEDTLS_MEMORY_BUFFER_ALLOC_C
#  include <mbedtls/memory_buffer_alloc.h>
static unsigned char heap[56240];
#else
#  error "TODO: no memory buffer configured"
#endif

#ifdef SYS_LOG_INF
#undef SYS_LOG_INF
#endif
#define SYS_LOG_INF printk
/*
 * This is the hard-coded root certificate that we accept.
 */
#include "sign.inc"
#include "globalsign.inc"

/*
 * Determine the length of an MQTT packet.
 *
 * Returns:
 *   > 0    The length, in bytes, of the MQTT packet this starts
 *   0      We don't have enough data to determine the length.
 *   -errno The packet is malformed.
 */
static int mqtt_length(u8_t *data, size_t len)
{
	u32_t size = 0;
	int shift = 0;
	int pos = 1;

	while (1) {
		if (pos >= 5) {
			return -EINVAL;
		}

		if (pos >= len) {
			return 0;
		}

		u8_t ch = data[pos];

		size |= (ch & 0x7F) << shift;

		if ((ch & 0x80) == 0) {
			break;
		}

		shift += 7;
		pos++;
	}

	return size + pos + 1;
}


static unsigned long int next = 1;

/* Return next random integer */

static u32_t _rand(void)

{

    next = next * 1103515245L + 12345;

    return (unsigned int) (next / 65536L) % 32768L;

}

static int entropy_source(void *data, unsigned char *output, size_t len,
			  size_t *olen)
{
	u32_t seed;

	// TODO: Don't use sys_rand32_get(), but instead use the
	// entropy device, and fail if it isn't available.

	ARG_UNUSED(data);

	seed = _rand();

	if (len > sizeof(seed)) {
		len = sizeof(seed);
	}

	memcpy(output, &seed, len);

	*olen = len;

	return 0;
}

static void my_debug(void *ctx, int level,
		     const char *file, int line, const char *str)
{
	const char *p, *basename;
	int len;

	ARG_UNUSED(ctx);

	/* Extract basename from file */
	for (p = basename = file; *p != '\0'; p++) {
		if (*p == '/' || *p == '\\') {
			basename = p + 1;
		}

	}

	/* Avoid printing double newlines */
	len = strlen(str);
	if (str[len - 1] == '\n') {
		((char *)str)[len - 1] = '\0';
	}

	SYS_LOG_INF("%s:%04d: |%d| %s", basename, line, level, str);
}

static mbedtls_ssl_context the_ssl;
static mbedtls_ssl_config the_conf;
static mbedtls_entropy_context entropy;
static mbedtls_ctr_drbg_context ctr_drbg;
static int sock;

/* State information.  This really should be in a structure per
 * instance. */
static bool got_reply;
static bool got_connected = false;

static u8_t send_buf[1024];
static u8_t recv_buf[1024];
static size_t recv_used;
//static u8_t token[512];

/* A queue of publish replies we need to return. */
#define PUBACK_SIZE 8  /* Change macro if not power of two */
#define INC_PUBACK_Q(x__) (((x__) + 1) & (PUBACK_SIZE - 1))
static u16_t puback_ids[PUBACK_SIZE];
static u16_t puback_head, puback_tail;

/* The next time we should send a keep-alive packet. */
u32_t idle_counter = 0;
u32_t pre_idle_counter = 0;
//#define ALIVE_TIME (30 * MSEC_PER_SEC)
#define ALIVE_TIME (30)


static void process_connack(u8_t *buf, size_t size)
{
	u8_t session;
	u8_t connect_rc;

	int res = mqtt_unpack_connack(buf, size, &session, &connect_rc);
	if (res < 0) {
		SYS_LOG_ERR("Malformed CONNACK received");
		return;
	}

	if (connect_rc != 0) {
		SYS_LOG_ERR("Error establishing connection: %d", connect_rc);
		return;
	}

	printk("Got connack\n");
	got_reply = true;
}

static void process_suback(u8_t *buf, size_t size)
{
	u16_t pkt_id;
	u8_t items;
	enum mqtt_qos granted_qos[4];

	int res = mqtt_unpack_suback(buf, size, &pkt_id,
				     &items, ARRAY_SIZE(granted_qos),
				     granted_qos);
	if (res < 0) {
		SYS_LOG_ERR("Malformed SUBACK message");
		return;
	}

	printk("Got suback: id:%d, items:%d, qos[0]:%d\n",
	       pkt_id, items, granted_qos[0]);
	got_reply = true;
}

static void process_publish(u8_t *buf, size_t size)
{
	struct mqtt_publish_msg incoming_publish;

	int res = mqtt_unpack_publish(buf, size, &incoming_publish);
	if (res < 0) {
		SYS_LOG_ERR("Malformed PUBLISH message");
		return;
	}

	if (incoming_publish.qos != MQTT_QoS1) {
		SYS_LOG_ERR("Unsupported QOS on publish");
		return;
	}

	printk("Got publish: id:%d\n", incoming_publish.pkt_id);

	/* Queue this up. */
	puback_ids[puback_head] = incoming_publish.pkt_id;
	puback_head = INC_PUBACK_Q(puback_head);

	if (puback_head == puback_tail) {
		SYS_LOG_ERR("Too many pub ack replies came in!");
	}
}

static void process_puback(u8_t *buf, size_t size)
{
	u16_t pkt_id;

	int res = mqtt_unpack_puback(buf, size, &pkt_id);
	if (res < 0) {
		SYS_LOG_ERR("Malformed PUBACK message");
		return;
	}

	printk("Got puback: id:%d\n", pkt_id);
	got_reply = true;
}

static void process_packet(u8_t *buf, size_t size)
{
	switch (MQTT_PACKET_TYPE(buf[0])) {
	case MQTT_CONNACK:
		process_connack(buf, size);
		break;
	case MQTT_SUBACK:
		process_suback(buf, size);
		break;
	case MQTT_PUBLISH:
		process_publish(buf, size);
		break;
	case MQTT_PUBACK:
		process_puback(buf, size);
		break;
	case MQTT_PINGRESP:
		printk("Ping response\n");
		break;
	default:
		SYS_LOG_ERR("Unsupported packet received: %x", buf[0]);
		break;
	}
}

static int check_read(mbedtls_ssl_context *context)
{
	int res = mbedtls_ssl_read(context,
				   recv_buf + recv_used,
				   sizeof(recv_buf) - recv_used);
	if (res <= 0) {
		return res;
	}

	recv_used += res;

	int size = mqtt_length(recv_buf, recv_used);
	printk("Read: %d (%d) size=%d\n", res, recv_used, size);

	while (size > 0 && size <= recv_used) {
		if (size > sizeof(recv_buf)) {
			printk("FAILURE: received packet larger than buffer: %d > %d\n",
				    size, sizeof(recv_buf));
			// TODO: Discard this packet, although there probably
			// isn't really a way to recover from this.
			return res;
		}

		printk("Process packet: %x\n", recv_buf[0]);
		pdump(recv_buf, recv_used);

		process_packet(recv_buf, size);

		/* Consume this part of the buffer, moving any
		 * remaining to the start. */

		if (recv_used > size) {
			memmove(recv_buf, recv_buf + size, recv_used - size);
		}

		recv_used -= size;

		size = mqtt_length(recv_buf, recv_used);
	}

	return res;
}

static int tcp_tx(void *ctx,
		  const unsigned char *buf,
		  size_t len)
{
	int sock = *((int *) ctx);
	int count = 0;
	/* Ideally, don't try to send more than is allowed.  TLS will
	 * reassemble on the other end. */

//	mbedtls_debug_print_buf(&the_ssl, 4, __FILE__, __LINE__, "tcp_tx", buf, len);
//	printf("SEND: %d to %d\n", len, sock);

#if 0
	int res = zsock_send(sock, buf, len, ZSOCK_MSG_DONTWAIT);
	if (res >= 0) {
		return res;
	}

	if (res != len) {
		printf("Short send: %d\n", res);
	}
#else
    uart_irq_tx_enable(foo_data.uart_dev);

	while(count < len){
		/* try to send some data */
		count += uart_fifo_fill(foo_data.uart_dev, buf + count, len - count);
	}
    if (count > 0) {
        printk("tcp tx %d, %d\n", count, len);
        printk("----- SEND -----\n");
        pdump(buf, count);
        printk("----- END SEND -----\n");
        return count;
    }
#endif
//  printk("----- SEND -----\n");
//	pdump(buf, count);
//	printk("----- END SEND -----\n");

	switch errno {
	case EAGAIN:
		printk("Waiting for write, res: %d\n", len);
		return MBEDTLS_ERR_SSL_WANT_WRITE;

	default:
		return MBEDTLS_ERR_NET_SEND_FAILED;
	}
}

static int tcp_isr(struct device *dev)
{
    int count;
    queue_element_type c;
    int rlen;

    uart_irq_update(dev);

    while(uart_irq_rx_ready(foo_data.uart_dev)){
        /* read into circular buffer onto head */
        uart_fifo_read(dev, &c, 1);
        en_queue(&tcp_q, c);
    }
}


static int tcp_rx(void *ctx,
		  unsigned char *buf,
		  size_t len)
{
	int res;
	int sock = *((int *) ctx);
	int count = 0;
    queue_element_type c;
	int rlen;

    int rec_time = 0;
    int lent = len;
    while(empty_queue(&tcp_q) && rec_time < 0x1FFFFF)rec_time++;
    if (rec_time > 0xFFFFF) {
        return MBEDTLS_ERR_SSL_WANT_READ;
    }
    rec_time = 0;
    while (count < len && rec_time < 1500){
        if(de_queue(&tcp_q, buf + count))
            count ++;
        else
            rec_time++;
    }
    if (count >= 0)
        {
        printk("tcp rx %d, %d\n", count, len);
        printk("----- RECV -----\n");
        pdump(buf, count);
        printk("----- END RECV -----\n");
        return lent;
    }

	switch errno {
	case EAGAIN:
		return MBEDTLS_ERR_SSL_WANT_READ;

	default:
		return MBEDTLS_ERR_NET_RECV_FAILED;
	}
}

const char *pers = "mini_client";  // What is this?

typedef int (*tls_action)(void *data);

/*
 * A driving loop for mbed TLS.  Invokes 'op' with 'data'.  This is
 * expected to return one of the MBEDTLS errors, with
 * MBEDTLS_ERR_SSL_WANT_READ and MBEDTLS_ERR_SSL_WANT_WRITE handled
 * specifically by this code.  This will return when the operation
 * returns any other status result.
 */
static int tls_perform(tls_action action, void *data)
{
	int res = action(data);
	short events = 0;
	while (1) {
		SYS_LOG_INF("tls_perform loop: %d", res);
		switch (res) {
		case MBEDTLS_ERR_SSL_WANT_READ:
			events = ZSOCK_POLLIN;
			break;

		case MBEDTLS_ERR_SSL_WANT_WRITE:
			events = ZSOCK_POLLOUT;
			break;

		default:
			/* Any other result is directly returned. */
			return res;
		}

		struct zsock_pollfd fds[1] = {
			[0] = {
				.fd = sock,
				.events = events,
				.revents = 0,
			},
		};

		SYS_LOG_INF("polling: %d", events);
        k_sleep(500);
        res = 0;
//      res = zsock_poll(fds, 1, 250);
		if (res < 0) {
			SYS_LOG_ERR("Socket poll error: %d\n", errno);
			return -errno;
		}

		res = action(data);
	}
}

/* An action to perform the TLS handshaking.  Data should be a pointer
 * to the mbedtls_ssl_context. */
static int action_handshake(void *data)
{
	mbedtls_ssl_context *ssl = data;

	return mbedtls_ssl_handshake(ssl);
}

struct write_action {
	mbedtls_ssl_context *context;
	const unsigned char *buf;
	size_t len;
};

/* An action to write data over the connection.  The data should be a
 * pointer to a struct write_action.  This will also try reading data
 * and processing it as MQTT received data.
 *
 * It is a little complex if we get blocked on both read and write.
 * Currently, this doesn't ever happen (writes don't block in the
 * Zephyr socket code as currently implemented).
 */
static int action_write(void *data)
{
	struct write_action *act = data;
#if 0
	/* Try the read first, in order to process the received data.
	 */
	int res = check_read(act->context);
	if (res == MBEDTLS_ERR_SSL_WANT_READ ||
		   res == MBEDTLS_ERR_SSL_WANT_WRITE) {
		/* This is kind of the "normal" case of no data being
		 * available. */
	} else if (res < 0) {
		/* Some kind of error, so return that. */
		return res;
	}
#endif
	/* At this point, we read, so now try the write. */
	return mbedtls_ssl_write(act->context, act->buf, act->len);
}

struct idle_action {
	mbedtls_ssl_context *context;
};

/* An action when we have nothing to do.  This will try reading, and
 * delay for a single polling interval.  The polling will then allow
 * for other operations to happen.  The main loop will not return
 * unless there is an error. */
static int action_idle(void *data)
{
	struct idle_action *act = data;
    uint32_t args[4] = {0};

	printk("\n idle counter %d %d\n",idle_counter, pre_idle_counter);
    tfm_core_test_svc(tfm_led_veneer_toggle, args);
    if (got_connected && ((idle_counter - pre_idle_counter) > ALIVE_TIME)) {
        pre_idle_counter = idle_counter;
        return 1;
    }
	/* If we need to send a keep alive, just return immediately.
	 */
        if (got_connected)
            idle_counter++;

	int res = check_read(act->context);
    printk("idle %d %d %d %d\n", res, got_reply, puback_head, puback_tail);
	if (res > 0 && !got_reply && (puback_head == puback_tail)) {
		/* In the valid case, just wait for more data. */
		res = MBEDTLS_ERR_SSL_WANT_READ;
	}

	return res;
}

/*
 * A TLS client, using mbed TLS.
 */
void tls_client(const char *hostname, struct zsock_addrinfo *host, int port)
{
	int res;

	mbedtls_platform_set_time(k_time);

#ifdef MBEDTLS_X509_CRT_PARSE_C
	mbedtls_x509_crt ca;
#else
#	error "Must define MBEDTLS_X509_CRT_PARSE_C"
#endif

	mbedtls_platform_set_printf(PRINT);

	/*
	 * 0. Initialize mbed TLS.
	 */
	mbedtls_ctr_drbg_init(&ctr_drbg);
	mbedtls_ssl_init(&the_ssl);
	mbedtls_ssl_config_init(&the_conf);
	mbedtls_x509_crt_init(&ca);

	SYS_LOG_INF("Seeding the random number generator...");
	mbedtls_entropy_init(&entropy);
	mbedtls_entropy_add_source(&entropy, entropy_source, NULL,
				   MBEDTLS_ENTROPY_MAX_GATHER,
				   MBEDTLS_ENTROPY_SOURCE_STRONG);

	if (mbedtls_ctr_drbg_seed(&ctr_drbg, mbedtls_entropy_func, &entropy,
				  (const unsigned char *)pers,
				  strlen(pers)) != 0) {
		SYS_LOG_ERR("Unable to init drbg");
		return;
	}

	SYS_LOG_INF("Setting up the TLS structure");
	if (mbedtls_ssl_config_defaults(&the_conf,
					MBEDTLS_SSL_IS_CLIENT,
					MBEDTLS_SSL_TRANSPORT_STREAM,
					MBEDTLS_SSL_PRESET_DEFAULT) != 0) {
		SYS_LOG_ERR("Unable to setup ssl config");
		return;
	}

	mbedtls_ssl_conf_dbg(&the_conf, my_debug, NULL);

	mbedtls_ssl_conf_rng(&the_conf, mbedtls_ctr_drbg_random, &ctr_drbg);

	/* MBEDTLS_MEMORY_BUFFER_ALLOC_C */
	mbedtls_memory_buffer_alloc_init(heap, sizeof(heap));

	/*
	 * Never disable root cert verification, like this.
	 */
#if 1
	/* Load the intended root cert in. */
	if (mbedtls_x509_crt_parse_der(&ca, globalsign_certificate,
				       sizeof(globalsign_certificate)) != 0) {
		SYS_LOG_ERR("Unable to decode root cert");
		return;
	}

	/* And configure tls to require the other side of the
	 * connection to use a cert signed by this certificate.
	 * This makes things fragile, as we are tied to a specific
	 * certificate. */
	mbedtls_ssl_conf_ca_chain(&the_conf, &ca, NULL);
	mbedtls_ssl_conf_authmode(&the_conf, MBEDTLS_SSL_VERIFY_REQUIRED);
#else
	mbedtls_ssl_conf_authmode(&the_conf, MBEDTLS_SSL_VERIFY_NONE);
#endif

	 mbedtls_debug_set_threshold(3);
	if (mbedtls_ssl_setup(&the_ssl, &the_conf) != 0) {
		SYS_LOG_ERR("Error running mbedtls_ssl_setup");
		return;
	}

	/* Certificate verification requires matching against an
	 * expected hostname.  Use the one we looked up.
	 * TODO: Make this only occur once in the code.
	 */
	if (mbedtls_ssl_set_hostname(&the_ssl, hostname) != 0) {
		SYS_LOG_ERR("Error setting target hostname");
	}

	SYS_LOG_INF("tls init done");

	SYS_LOG_INF("Connecting to tcp '%s'", hostname);
#if 0
	SYS_LOG_INF("Creating socket");
	sock = zsock_socket(AF_INET, SOCK_STREAM, IPPROTO_TCP);
	if (sock == -1) {
		SYS_LOG_ERR("Failed to create socket");
		return;
	}

	SYS_LOG_INF("connecting...");
    res = zsock_connect(sock, host->ai_addr, host->ai_addrlen);
	if (res == -1) {
		SYS_LOG_ERR("Failed to connect to socket");
		return;
	}
#else
    initial_queue(&tcp_q, ESP8266_TCP_RCV_BUF_MAX);
    uart_irq_callback_set(foo_data.uart_dev, tcp_isr);

    uart_irq_rx_enable(foo_data.uart_dev);

#endif
	SYS_LOG_INF("Connected");

	mbedtls_ssl_set_bio(&the_ssl, &sock, tcp_tx, tcp_rx, NULL);

	SYS_LOG_INF("Performing TLS handshake");
	SYS_LOG_INF("State: %d", the_ssl.state);
	// mbedtls_debug_set_threshold(2);

	res = tls_perform(action_handshake, &the_ssl);
	if (res != 0) {
		SYS_LOG_INF("Error on tls handshake: %d", res);
		return;
	}
	if (the_ssl.state != MBEDTLS_SSL_HANDSHAKE_OVER) {
		SYS_LOG_INF("SSL handshake did not complete: %d", the_ssl.state);
		return;
	}

	SYS_LOG_ERR("Done with TCP client startup");
}

//static const char client_id[] = "projects/macro-precinct-211108/locations/us-central1/registries/agross-registry/devices/karl-zh-ec";
static const char client_id[] = "projects/our-chassis-213317/locations/us-central1/registries/musca_ecdsa/devices/arm_eval";


#if 0
static void show_stack(void)
{
	static bool once = false;

	extern u8_t _main_stack[];

	if (!once) {
		once = true;
		// pdump(_main_stack, CONFIG_MAIN_STACK_SIZE);
		// pdump(heap, sizeof(heap));
		mbedtls_memory_buffer_alloc_status();
	}
}
#endif

#define TOPIC "/devices/arm_eval/state"
static void publish_state(void)
{
    char pubmsg[64];
    int res;
	u16_t send_len = 0;
	struct write_action wract = {
		.context = &the_ssl,
		.buf = send_buf,
		.len = send_len,
	};
    sprintf(pubmsg, "Pub:%d, %d\n", _rand(), idle_counter);
	/* Try sending a state update. */
	struct mqtt_publish_msg pmsg = {
		.dup = 0,
		.qos = MQTT_QoS1,
		.retain = 1,
		.pkt_id = 0xfd12,
		.topic = TOPIC,
		.topic_len = strlen(TOPIC),
		.msg = pubmsg,
		.msg_len = strlen(pubmsg),
	};
	res = mqtt_pack_publish(send_buf, &send_len, sizeof(send_buf),
				&pmsg);

	wract.buf = send_buf;
	wract.len = send_len;
	pdump(send_buf, send_len);
	res = tls_perform(action_write, &wract);
	printk("Send result: %d\n", res);
	if (res < 0) {
		return;
	}
	if (res != send_len) {
		printk("Short send\n");
	}
    printk("Publish packet: res=%d, len=%d\n", res, send_len);
}

void mqtt_startup(void)
{
	struct mqtt_connect_msg conmsg;
	struct jwt_builder jb;
    int res;

#if 0
	time_t now = k_time(NULL);
    res = jwt_init_builder(&jb, token, sizeof(token));
	if (res != 0) {
		printk("Error with JWT token\n");
		return;
	}

	res = jwt_add_payload(&jb, now + 60 * 60, now,
			      AUDIENCE);
	if (res != 0) {
		printk("Error with JWT token\n");
		return;
	}

#ifdef CONFIG_JWT_SIGN_RSA
	res = jwt_sign(&jb, zepfull_private_der, zepfull_private_der_len);
#endif
#ifdef CONFIG_JWT_SIGN_ECDSA
	res = jwt_sign(&jb, zepfull_ec_private_der, zepfull_ec_private_der_len);
#endif
	if (res != 0) {
		printk("Error with JWT token\n");
		return;
	}
#endif

	memset(&conmsg, 0, sizeof(conmsg));

	conmsg.clean_session = 1;
	conmsg.client_id = (char *)client_id;  /* Discard const */
	conmsg.client_id_len = strlen(client_id);
    conmsg.keep_alive = 60 * 60; /* Two minutes */
	conmsg.password = jwt_buffer;
	conmsg.password_len = strlen(jwt_buffer);

	printk("len1 = %d, len2 = %d\n", conmsg.password_len,
	       strlen(jwt_buffer));

	u16_t send_len = 0;
	res = mqtt_pack_connect(send_buf, &send_len, sizeof(send_buf),
				    &conmsg);
	printk("build packet: res = %d, len=%d\n", res, send_len);

	struct write_action wract = {
		.context = &the_ssl,
		.buf = send_buf,
		.len = send_len,
	};

	pdump(send_buf, send_len);
	res = tls_perform(action_write, &wract);
//    action_write(&wract);


	while (!got_reply) {
		printk("Waiting for CONNACT\n");
		struct idle_action idact = {
			.context = &the_ssl,
		};

		res = tls_perform(action_idle, &idact);
		if (res <= 0) {
			printk("Idle error: %d\n", res);
			return;
		}
	}

	printk("Done with connect\n");
	got_reply = false;
    got_connected = true;

#if 1
	/* Try subscribing to the device state message. */
	static const char *topics[] = {
        "/devices/arm_eval/config",
	};
	static const enum mqtt_qos qoss[] = {
		MQTT_QoS1,
	};
	res = mqtt_pack_subscribe(send_buf, &send_len, sizeof(send_buf),
				  _rand() & 0xFFFF, 1, topics, qoss);
	printk("Subscribe packet: res=%d, len=%d\n", res, send_len);

#else

//#define TOPIC "/devices/zepfull/state"
#define TOPIC "/devices/karl-zh-ec/state"

#define MESSAGE "Some more state"
	/* Try sending a state update. */
	struct mqtt_publish_msg pmsg = {
		.dup = 0,
		.qos = MQTT_QoS1,
		.retain = 1,
		.pkt_id = 0xfd12,
		.topic = TOPIC,
		.topic_len = strlen(TOPIC),
		.msg = MESSAGE,
		.msg_len = strlen(MESSAGE),
	};
	res = mqtt_pack_publish(send_buf, &send_len, sizeof(send_buf),
				&pmsg);
	printk("Publish packet: res=%d, len=%d\n", res, send_len);
#endif
	wract.buf = send_buf;
	wract.len = send_len;
	pdump(send_buf, send_len);
	res = tls_perform(action_write, &wract);
	printk("Send result: %d\n", res);
	if (res < 0) {
		return;
	}
	if (res != send_len) {
		printk("Short send\n");
	}

#if 1
	while (!got_reply) {
		printk("Waiting for SUBACK\n");
		struct idle_action idact = {
			.context = &the_ssl,
		};

		res = tls_perform(action_idle, &idact);
		if (res <= 0) {
			printk("Idle error: %d\n", res);
			return;
		}
	}
#endif

	got_reply = 0;
    publish_state();

    res = mqtt_pack_pingreq(send_buf, &send_len, sizeof(send_buf));
    printk("Send 1st ping, res=%d, len=%d\n", res, send_len);

    wract.buf = send_buf;
    wract.len = send_len;
    pdump(send_buf, send_len);
    res = tls_perform(action_write, &wract);

    if (res != send_len) {
        SYS_LOG_ERR("Problem sending ping: %d", res);
    }

	while (1) {

               struct idle_action idact = {
                       .context = &the_ssl,
               };

               res = tls_perform(action_idle, &idact);
               if (res <= 0) {
                       printk("Idle error: %d\n", res);
                       return;
               }


		while (puback_head != puback_tail) {
			printk("head=%d, tail=%d\n", puback_head, puback_tail);
			/* Send the puback back so that the remote
			 * feels we have received the message. */
			res = mqtt_pack_puback(send_buf, &send_len, sizeof(send_buf),
					       puback_ids[puback_tail]);
			printk("Send Puback: res=%d, len=%d\n", res, send_len);

			puback_tail = INC_PUBACK_Q(puback_tail);

			wract.buf = send_buf;
			wract.len = send_len;
			pdump(send_buf, send_len);
			res = tls_perform(action_write, &wract);

			if (res != send_len) {
				SYS_LOG_ERR("Problem sending PUBACK: %d", res);
			}

		}

		if (res == 1) {
			res = mqtt_pack_pingreq(send_buf, &send_len, sizeof(send_buf));
			printk("Send ping, res=%d, len=%d\n", res, send_len);

			wract.buf = send_buf;
			wract.len = send_len;
			pdump(send_buf, send_len);
			res = tls_perform(action_write, &wract);

			if (res != send_len) {
				SYS_LOG_ERR("Problem sending ping: %d", res);
			}

            publish_state();
			// show_stack();
		}
	}
}
```
