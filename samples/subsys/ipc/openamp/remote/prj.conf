## CMakeLists.txt
```
cmake_minimum_required(VERSION 3.13.1)
# Copyright (c) 2018 Nordic Semiconductor ASA
#
# SPDX-License-Identifier: Apache-2.0
#
set(BOARD mps2_an521_nonsecure)

include($ENV{ZEPHYR_BASE}/cmake/app/boilerplate.cmake NO_POLICY_SCOPE)
project(openamp_remote)

#set(ERPC_DIR "$ENV{ZEPHYR_BASE}/../erpc/")
set(ERPC_DIR "/home/karzha01/LinaroWork/castor_zephyr/erpc/")

zephyr_library_link_libraries(${ERPC_DIR}/build/release/liberpc_client.a)

set(SERVICE_DIR "${ERPC_DIR}/service/")

#if(NOT ("${BOARD}" STREQUAL "lpcxpresso54114_m0"))
#  message(FATAL_ERROR "${BOARD} was specified, but this sample only supports lpcxpresso54114_m0")
#endif()

target_sources(app PRIVATE src/main.c)
target_include_directories(app PRIVATE ${CMAKE_CURRENT_SOURCE_DIR}/..)
target_include_directories(app PRIVATE ${CMAKE_CURRENT_SOURCE_DIR}/tfm/inc)

target_include_directories(app PRIVATE ${SERVICE_DIR})
target_include_directories(app PRIVATE ${ERPC_DIR}/erpc_c/infra)
target_include_directories(app PRIVATE ${ERPC_DIR}/erpc_c/port)
target_include_directories(app PRIVATE ${ERPC_DIR}/erpc_c/config)
target_include_directories(app PRIVATE ${ERPC_DIR}/erpc_c/setup)
```

## prj.conf
```kconfig
CONFIG_STDOUT_CONSOLE=n
CONFIG_PRINTK=n
CONFIG_IPM=y
#CONFIG_IPM_MCUX=y
CONFIG_PLATFORM_SPECIFIC_INIT=n
CONFIG_HEAP_MEM_POOL_SIZE=4096
CONFIG_OPENAMP=y
CONFIG_SEGGER_RTT_BUFFER_SIZE_UP=4096
CONFIG_IPM_MHU=y
```

## src/main.c
```c
/*
 * Copyright (c) 2018, NXP
 * Copyright (c) 2018, Nordic Semiconductor ASA
 * Copyright (c) 2018-2019, Linaro Limited
 *
 * SPDX-License-Identifier: Apache-2.0
 */

#include <zephyr.h>
#include <drivers/ipm.h>
#include <sys/printk.h>
#include <device.h>
#include <stdio.h>
#include <stdlib.h>
#include <string.h>

#include <openamp/open_amp.h>
#include <metal/device.h>

#include "common.h"

#define APP_TASK_STACK_SIZE (1024)
K_THREAD_STACK_DEFINE(thread_stack, APP_TASK_STACK_SIZE);
static struct k_thread thread_data;

static struct device *ipm_handle;

static metal_phys_addr_t shm_physmap[] = { SHM_START_ADDR };
static struct metal_device shm_device = {
	.name = SHM_DEVICE_NAME,
	.bus = NULL,
	.num_regions = 1,
	{
		{
			.virt       = (void *) SHM_START_ADDR,
			.physmap    = shm_physmap,
			.size       = SHM_SIZE,
			.page_shift = 0xffffffff,
			.page_mask  = 0xffffffff,
			.mem_flags  = 0,
			.ops        = { NULL },
		},
	},
	.node = { NULL },
	.irq_num = 0,
	.irq_info = NULL
};

static volatile unsigned int received_data;

static struct virtio_vring_info rvrings[2] = {
	[0] = {
		.info.align = VRING_ALIGNMENT,
	},
	[1] = {
		.info.align = VRING_ALIGNMENT,
	},
};
static struct virtio_device vdev;
static struct rpmsg_virtio_device rvdev;
static struct metal_io_region *io;
static struct virtqueue *vq[2];

static unsigned char virtio_get_status(struct virtio_device *vdev)
{
	return sys_read8(VDEV_STATUS_ADDR);
}

static u32_t virtio_get_features(struct virtio_device *vdev)
{
	return 1 << VIRTIO_RPMSG_F_NS;
}

static void virtio_notify(struct virtqueue *vq)
{
#if defined(CONFIG_SOC_MPS2_AN521)
	u32_t current_core = sse_200_platform_get_cpu_id();

	ipm_send(ipm_handle, 0, current_core ? 0 : 1, 0, 1);
#else
	u32_t dummy_data = 0x00110011; /* Some data must be provided */

	ipm_send(ipm_handle, 0, 0, &dummy_data, sizeof(dummy_data));
#endif /* #if defined(CONFIG_SOC_MPS2_AN521) */
}

struct virtio_dispatch dispatch = {
	.get_status = virtio_get_status,
	.get_features = virtio_get_features,
	.notify = virtio_notify,
};

static K_SEM_DEFINE(data_sem, 0, 1);
static K_SEM_DEFINE(data_rx_sem, 0, 1);

static void platform_ipm_callback(void *context, u32_t id, volatile void *data)
{
	k_sem_give(&data_sem);
}

int endpoint_cb(struct rpmsg_endpoint *ept, void *data,
		size_t len, u32_t src, void *priv)
{
	received_data = *((unsigned int *) data);

	k_sem_give(&data_rx_sem);

	return RPMSG_SUCCESS;
}

static K_SEM_DEFINE(ept_sem, 0, 1);

struct rpmsg_endpoint my_ept;
struct rpmsg_endpoint *ep = &my_ept;

static void rpmsg_service_unbind(struct rpmsg_endpoint *ept)
{
	(void)ept;
	rpmsg_destroy_ept(ep);
}

static unsigned int receive_message(void)
{
	while (k_sem_take(&data_rx_sem, K_NO_WAIT) != 0) {
		int status = k_sem_take(&data_sem, K_FOREVER);

		if (status == 0) {
			virtqueue_notification(vq[1]);
		}
	}
	return received_data;
}

static int send_message(unsigned int message)
{
	return rpmsg_send(ep, &message, sizeof(message));
}

void app_task(void *arg1, void *arg2, void *arg3)
{
	ARG_UNUSED(arg1);
	ARG_UNUSED(arg2);
	ARG_UNUSED(arg3);
	int status = 0;
	unsigned int message = 0U;
	struct metal_device *device;
	struct rpmsg_device *rdev;
	struct metal_init_params metal_params = METAL_INIT_DEFAULTS;

	printk("\r\nOpenAMP[remote] demo started\r\n");

	status = metal_init(&metal_params);
	if (status != 0) {
		printk("metal_init: failed - error code %d\n", status);
		return;
	}

	status = metal_register_generic_device(&shm_device);
	if (status != 0) {
		printk("Couldn't register shared memory device: %d\n", status);
		return;
	}

	status = metal_device_open("generic", SHM_DEVICE_NAME, &device);
	if (status != 0) {
		printk("metal_device_open failed: %d\n", status);
		return;
	}

	io = metal_device_io_region(device, 0);
	if (io == NULL) {
		printk("metal_device_io_region failed to get region\n");
		return;
	}

	/* setup IPM */
	ipm_handle = device_get_binding(DT_IPM_DEV);
	if (ipm_handle == NULL) {
		printk("device_get_binding failed to find device\n");
		return;
	}

	ipm_register_callback(ipm_handle, platform_ipm_callback, NULL);

	status = ipm_set_enabled(ipm_handle, 1);
	if (status != 0) {
		printk("ipm_set_enabled failed\n");
		return;
	}

	/* setup vdev */
	vq[0] = virtqueue_allocate(VRING_SIZE);
	if (vq[0] == NULL) {
		printk("virtqueue_allocate failed to alloc vq[0]\n");
		return;
	}
	vq[1] = virtqueue_allocate(VRING_SIZE);
	if (vq[1] == NULL) {
		printk("virtqueue_allocate failed to alloc vq[1]\n");
		return;
	}

	vdev.role = RPMSG_REMOTE;
	vdev.vrings_num = VRING_COUNT;
	vdev.func = &dispatch;
	rvrings[0].io = io;
	rvrings[0].info.vaddr = (void *)VRING_TX_ADDRESS;
	rvrings[0].info.num_descs = VRING_SIZE;
	rvrings[0].info.align = VRING_ALIGNMENT;
	rvrings[0].vq = vq[0];

	rvrings[1].io = io;
	rvrings[1].info.vaddr = (void *)VRING_RX_ADDRESS;
	rvrings[1].info.num_descs = VRING_SIZE;
	rvrings[1].info.align = VRING_ALIGNMENT;
	rvrings[1].vq = vq[1];

	vdev.vrings_info = &rvrings[0];

	/* setup rvdev */
	status = rpmsg_init_vdev(&rvdev, &vdev, NULL, io, NULL);
	if (status != 0) {
		printk("rpmsg_init_vdev failed %d\n", status);
		return;
	}

	rdev = rpmsg_virtio_get_rpmsg_device(&rvdev);

	status = rpmsg_create_ept(ep, rdev, "k", RPMSG_ADDR_ANY,
			RPMSG_ADDR_ANY, endpoint_cb, rpmsg_service_unbind);
	if (status != 0) {
		printk("rpmsg_create_ept failed %d\n", status);
		return;
	}

	while (message < 99) {
		message = receive_message();
		printk("Remote core received a message: %d\n", message);

		message++;
		status = send_message(message);
		if (status < 0) {
			printk("send_message(%d) failed with status %d\n",
			       message, status);
			goto _cleanup;
		}
	}

_cleanup:
	rpmsg_deinit_vdev(&rvdev);
	metal_finish();

	printk("OpenAMP demo ended.\n");
}

void main(void)
{
	printk("Starting application thread!\n");
	k_thread_create(&thread_data, thread_stack, APP_TASK_STACK_SIZE,
			(k_thread_entry_t)app_task,
			NULL, NULL, NULL, K_PRIO_COOP(7), 0, 0);
}
```

## src/main_remote.c
```c
/*
 * Copyright (c) 2018, NXP
 * Copyright (c) 2018 Nordic Semiconductor ASA
 *
 * SPDX-License-Identifier: Apache-2.0
 *
 * This implements the remote side of an OpenAMP system.
 */

#include <zephyr.h>
#include <misc/printk.h>
#include <device.h>
#include <stdio.h>
#include <stdlib.h>
#include <string.h>

#include <openamp/open_amp.h>

#include "platform.h"
#include "resource_table.h"
#include "erpc_psa_api.h"

#define APP_TASK_STACK_SIZE (512)
K_THREAD_STACK_DEFINE(thread_stack, APP_TASK_STACK_SIZE);
static struct k_thread thread_data;

static K_SEM_DEFINE(channel_created, 0, 1);

static K_SEM_DEFINE(message_received, 0, 1);
static volatile unsigned int received_data;

static struct rsc_table_info rsc_info;
static struct hil_proc *proc;

static struct rpmsg_channel *rp_channel;
static struct rpmsg_endpoint *rp_endpoint;

#define RCV_MSGQ 1

#if RCV_MSGQ
struct k_msgq rcv_msgq;
static char __aligned(4) tbuffer[MSG_SIZE * MSGQ_LEN];

static void rpmsg_recv_callback(struct rpmsg_channel *channel, void *data,
				int data_length, void *private,
				unsigned long src)
{
	int ret, rx_data;
	printk("Rrcv %d.\n", data_length);
	for (int i  = 0; i < data_length; i++) {
		rx_data = *((char *)data + i);
//		printk("%x ", rx_data);
		ret = k_msgq_put(&rcv_msgq, &rx_data, K_NO_WAIT);
		if (ret != 0)
			printk(" %s error.\n", __func__);
//		zassert_equal(ret, 0, NULL);
	}

//	received_data = *((unsigned int *) data);
	k_sem_give(&message_received);
}
#else
static struct rcv_buff rpmsg_recv = {{0}, 0, 0};

static void rpmsg_recv_callback(struct rpmsg_channel *channel, void *data,
				int data_length, void *private,
				unsigned long src)
{
	if (data_length < (RX_BUFF_SIZE - rpmsg_recv.start)) {
//		memset(rpmsg_recv.rcv, 0x00, RX_BUFF_SIZE);
		memcpy(rpmsg_recv.rcv + rpmsg_recv.len, (unsigned char *)data, data_length);
		rpmsg_recv.len += data_length;
		printk("Rrcv %d.\n", data_length);
	} else {
		printk("R %s received %d bytes.\n", __func__, data_length);
	}

//	received_data = *((unsigned int *) data);
	k_sem_give(&message_received);
}

#endif
static void rpmsg_channel_created(struct rpmsg_channel *channel)
{
	rp_channel = channel;
	rp_endpoint = rpmsg_create_ept(rp_channel, rpmsg_recv_callback,
				       RPMSG_NULL, RPMSG_ADDR_ANY);
	k_sem_give(&channel_created);
}

static void rpmsg_channel_deleted(struct rpmsg_channel *channel)
{
	rpmsg_destroy_ept(rp_endpoint);
}

static unsigned int receive_message(void)
{
	while (k_sem_take(&message_received, K_NO_WAIT) != 0)
		hil_poll(proc, 0);
	return received_data;
}

static int send_message(unsigned int message)
{
	return rpmsg_send(rp_channel, &message, sizeof(message));
}

void __assert_func (const char *file, int line, const char *func, const char *e)
{
	printk("%s,%s,%s\n");
}

void print_log(const char *fmt)
{
	printk(fmt);
}

int serial_write(int fd, char *buf, int size)
{
	printk("Rwrite %x, %d\n", buf, size);
//	return 0;
	return rpmsg_send(rp_channel, buf, size);
}

#if RCV_MSGQ
int serial_read(int fd, char *buf, int size)
{
	int ret, rx_data;
	if (size > k_msgq_num_used_get(&rcv_msgq)) {
		while (k_sem_take(&message_received, K_NO_WAIT) != 0)
			hil_poll(proc, 0);
	}

	for (int i = 0; i < size; i++) {
		ret = k_msgq_get(&rcv_msgq, &rx_data, K_NO_WAIT);
		buf[i] = (rx_data & 0xFF);
//		printk("%d ", buf[i]);
//		zassert_equal(ret, 0, NULL);
	}
	return size;
}
#else
int serial_read(int fd, char *buf, int size)
{
	printk("Rread %x, %d\n",buf, size);
	if (size > rpmsg_recv.len) {
		while (k_sem_take(&message_received, K_NO_WAIT) != 0)
			hil_poll(proc, 0);
	}

	memcpy(buf, rpmsg_recv.rcv + rpmsg_recv.start, size);
	rpmsg_recv.start += size;
	rpmsg_recv.len -= size;
	return size;
}
#endif
int serial_open(const char *port)
{
	printk("serial open %s\n", port);
	return 0;
}

int serial_close(int fd)
{
	return 0;
}

void app_task(void *arg1, void *arg2, void *arg3)
{
	ARG_UNUSED(arg1);
	ARG_UNUSED(arg2);
	ARG_UNUSED(arg3);

	struct metal_init_params metal_params = METAL_INIT_DEFAULTS;

	metal_init(&metal_params);

	proc = platform_init(RPMSG_REMOTE);
	if (proc == NULL) {
		goto _cleanup;
	}

	resource_table_init((void **) &rsc_info.rsc_tab, &rsc_info.size);

	struct remote_proc *rproc_ptr = NULL;
	int status = remoteproc_resource_init(&rsc_info, proc,
					      rpmsg_channel_created,
					      rpmsg_channel_deleted,
					      rpmsg_recv_callback,
					      &rproc_ptr, RPMSG_REMOTE);
	if (status != 0) {
		goto _cleanup;
	}

	while (k_sem_take(&channel_created, K_NO_WAIT) != 0)
		hil_poll(proc, 0);

	while (1) {
		k_sleep(500);
	}

	unsigned int message = 0U;

	while (message <= 100) {
		message = receive_message();
		message++;
		status = send_message(message);
		if (status <= 0) {
			goto _cleanup;
		}
	}

_cleanup:
	if (rproc_ptr) {
		remoteproc_resource_deinit(rproc_ptr);
	}
}
typedef struct ErpcMessageBufferFactory *erpc_mbf_t;
typedef struct ErpcTransport *erpc_transport_t;

void main(void)
{
	k_thread_create(&thread_data, thread_stack, APP_TASK_STACK_SIZE,
			(k_thread_entry_t)app_task,
			NULL, NULL, NULL, K_PRIO_COOP(7), 0, 0);

#if RCV_MSGQ
	k_msgq_init(&rcv_msgq, tbuffer, MSG_SIZE, MSGQ_LEN);
#endif

	 //  erpc_transport_t
	 erpc_transport_t transport = erpc_transport_serial_init("zssR", 115200);
//	erpc_mbf_t
	 erpc_mbf_t message_buffer_factory = erpc_mbf_static_init();

	erpc_client_init(transport ,message_buffer_factory);

	Matrix matrix1 = {3};
	Matrix matrix2 = {5};
	Matrix matrixR = {0};
	int matrix_size = 5, i, j;

    for (i = 0; i < matrix_size; ++i)
    {
        for (j = 0; j < matrix_size; ++j)
        {
            matrix1[i][j] = 3;
            matrix2[i][j] = 5;
        }
    }

	erpcMatrixMultiply(matrix1, matrix2, matrixR);
	printk("R %d\n", matrixR[2][2]);

	printk("PFV: %d\n", psa_framework_version());
	psa_version(matrix_size - 1);
	psa_connect(matrix_size - 2, matrix_size - 3);
	psa_call(1, matrix_size + 1, matrix_size + 2, matrix_size + 3, matrix_size + 4);
	psa_close(matrix_size);
}
```
