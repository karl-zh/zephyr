## CMakeLists.txt
```
cmake_minimum_required(VERSION 3.13.1)
# Copyright (c) 2018 Nordic Semiconductor ASA
# Copyright (c) 2019 Linaro Limited
#
# SPDX-License-Identifier: Apache-2.0
#

if("${BOARD}" STREQUAL "lpcxpresso54114_m4")
  set(BOARD_REMOTE "lpcxpresso54114_m0")
else()
  message(FATAL_ERROR "${BOARD} was not supported for this sample")
endif()

message(INFO " ${BOARD} compile as Master in this sample")

include($ENV{ZEPHYR_BASE}/cmake/app/boilerplate.cmake NO_POLICY_SCOPE)
project(openamp)

enable_language(C ASM)

target_sources(app PRIVATE src/main.c)

include(ExternalProject)

ExternalProject_Add(
  openamp_remote
  SOURCE_DIR ${APPLICATION_SOURCE_DIR}/remote
  INSTALL_COMMAND ""      # This particular build system has no install command
  CMAKE_CACHE_ARGS -DBOARD:string=${BOARD_REMOTE}
  CMAKE_CACHE_ARGS -DDTC_OVERLAY_FILE:string=${DTC_OVERLAY_FILE}
  CMAKE_CACHE_ARGS -DCONF_FILE:string=${CONF_FILE}
  BUILD_BYPRODUCTS "${CMAKE_CURRENT_BINARY_DIR}/openamp_remote-prefix/src/openamp_remote-build/zephyr/zephyr.bin"
  # NB: Do we need to pass on more CMake variables?
)

if(("${BOARD}" STREQUAL "lpcxpresso54114_m4"))
	add_dependencies(core_m0_inc_target openamp_remote)
endif()

target_include_directories(app PRIVATE ${CMAKE_CURRENT_SOURCE_DIR})
```

## sample.yaml
```
sample:
    description: This app provides an example of how to integrate OpenAMP
        with Zephyr.
    name: OpenAMP example integration
tests:
    sample.subsys.ipc.openamp.lpcx:
        build_only: true
        extra_args: CONF_FILE=lpcx.conf
        platform_whitelist: lpcxpresso54114_m4
        tags: ipm
    sample.subsys.ipc.openamp.mps2_an521:
        build_only: true
        extra_args: CONF_FILE=prj.conf
        platform_whitelist: mps2_an521
        tags: ipm
    sample.subsys.ipc.openamp.v2m_musca:
        build_only: true
        extra_args: CONF_FILE=prj.conf
        platform_whitelist: v2m_musca
        tags: ipm
```

## prj.conf
```kconfig
CONFIG_PRINTK=y
CONFIG_IPM=y
#CONFIG_IPM_MCUX=y
#CONFIG_SLAVE_CORE_MCUX=y
#CONFIG_SLAVE_IMAGE_MCUX="${ZEPHYR_BINARY_DIR}/../openamp_remote-prefix/src/openamp_remote-build/zephyr/zephyr.bin"
CONFIG_TIMESLICE_SIZE=1
CONFIG_MAIN_STACK_SIZE=2048
CONFIG_HEAP_MEM_POOL_SIZE=4096
CONFIG_OPENAMP=y
CONFIG_IPM_MHU=y
```

## lpcxpresso54114_m4.overlay
```dts
/*
 * Copyright (c) 2019 Linaro Limited
 *
 * SPDX-License-Identifier: Apache-2.0
 */

/ {
	chosen {
		/*
		 * shared memory reserved for the inter-processor communication
		 */
		zephyr,ipc_shm = &sramx1;
	};

	sramx1:memory@4000000{
		compatible = "mmio-sram";
		reg = <0x4000000 0x8000>;
	};
};
```

## mps2_an521.overlay
```dts
/*
 * Copyright (c) 2019 Linaro Limited
 *
 * SPDX-License-Identifier: Apache-2.0
 */

/ {
	chosen {
		/*
		 * shared memory reserved for the inter-processor communication
		 */
		zephyr,ipc_shm = &sramx;
	};

	sramx: memory@28180000 {
		compatible = "mmio-sram";
		reg = <0x28180000 0x8000>;
	};
};
```

## v2m_musca.overlay
```dts
/*
 * Copyright (c) 2019 Linaro Limited
 *
 * SPDX-License-Identifier: Apache-2.0
 */

/ {
	chosen {
		/*
		 * shared memory reserved for the inter-processor communication
		 */
		zephyr,ipc_shm = &sramx;
	};

	sramx: memory@20018000 {
		compatible = "mmio-sram";
		reg = <0x20018000 0x8000>;
	};
};
```

## src/main.c
```c
/*
 * Copyright (c) 2018, NXP
 * Copyright (c) 2018, Nordic Semiconductor ASA
 * Copyright (c) 2018-2019, Linaro Limited
 *
 * SPDX-License-Identifier: Apache-2.0
 */

#include <zephyr.h>
#include <drivers/ipm.h>
#include <sys/printk.h>
#include <device.h>
#include <stdio.h>
#include <stdlib.h>
#include <string.h>
#include <init.h>

#include <openamp/open_amp.h>
#include <metal/device.h>

#include "common.h"

#define APP_TASK_STACK_SIZE (1024)
K_THREAD_STACK_DEFINE(thread_stack, APP_TASK_STACK_SIZE);
static struct k_thread thread_data;

static struct device *ipm_handle;

static metal_phys_addr_t shm_physmap[] = { SHM_START_ADDR };
static struct metal_device shm_device = {
	.name = SHM_DEVICE_NAME,
	.bus = NULL,
	.num_regions = 1,
	{
		{
			.virt       = (void *) SHM_START_ADDR,
			.physmap    = shm_physmap,
			.size       = SHM_SIZE,
			.page_shift = 0xffffffff,
			.page_mask  = 0xffffffff,
			.mem_flags  = 0,
			.ops        = { NULL },
		},
	},
	.node = { NULL },
	.irq_num = 0,
	.irq_info = NULL
};

static volatile unsigned int received_data;

static struct virtio_vring_info rvrings[2] = {
	[0] = {
		.info.align = VRING_ALIGNMENT,
	},
	[1] = {
		.info.align = VRING_ALIGNMENT,
	},
};
static struct virtio_device vdev;
static struct rpmsg_virtio_device rvdev;
static struct metal_io_region *io;
static struct virtqueue *vq[2];

static unsigned char virtio_get_status(struct virtio_device *vdev)
{
	return VIRTIO_CONFIG_STATUS_DRIVER_OK;
}

static void virtio_set_status(struct virtio_device *vdev, unsigned char status)
{
	sys_write8(status, VDEV_STATUS_ADDR);
}

static u32_t virtio_get_features(struct virtio_device *vdev)
{
	return 1 << VIRTIO_RPMSG_F_NS;
}

static void virtio_set_features(struct virtio_device *vdev,
				u32_t features)
{
}

static void virtio_notify(struct virtqueue *vq)
{
#if defined(CONFIG_SOC_MPS2_AN521)
	u32_t current_core = sse_200_platform_get_cpu_id();

	ipm_send(ipm_handle, 0, current_core ? 0 : 1, 0, 1);
#else
	u32_t dummy_data = 0x55005500; /* Some data must be provided */

	ipm_send(ipm_handle, 0, 0, &dummy_data, sizeof(dummy_data));
#endif /* #if defined(CONFIG_SOC_MPS2_AN521) */
}

struct virtio_dispatch dispatch = {
	.get_status = virtio_get_status,
	.set_status = virtio_set_status,
	.get_features = virtio_get_features,
	.set_features = virtio_set_features,
	.notify = virtio_notify,
};

static K_SEM_DEFINE(data_sem, 0, 1);
static K_SEM_DEFINE(data_rx_sem, 0, 1);

static void platform_ipm_callback(void *context, u32_t id, volatile void *data)
{
	k_sem_give(&data_sem);
}

int endpoint_cb(struct rpmsg_endpoint *ept, void *data,
		size_t len, u32_t src, void *priv)
{
	received_data = *((unsigned int *) data);

	k_sem_give(&data_rx_sem);

	return RPMSG_SUCCESS;
}

static K_SEM_DEFINE(ept_sem, 0, 1);

struct rpmsg_endpoint my_ept;
struct rpmsg_endpoint *ep = &my_ept;

static void rpmsg_service_unbind(struct rpmsg_endpoint *ept)
{
	(void)ept;
	rpmsg_destroy_ept(ep);
}

void ns_bind_cb(struct rpmsg_device *rdev, const char *name, u32_t dest)
{
	(void)rpmsg_create_ept(ep, rdev, name,
			RPMSG_ADDR_ANY, dest,
			endpoint_cb,
			rpmsg_service_unbind);

	k_sem_give(&ept_sem);
}

static unsigned int receive_message(void)
{
	while (k_sem_take(&data_rx_sem, K_NO_WAIT) != 0) {
		int status = k_sem_take(&data_sem, K_FOREVER);

		if (status == 0) {
			virtqueue_notification(vq[0]);
		}
	}
	return received_data;
}

static int send_message(unsigned int message)
{
	return rpmsg_send(ep, &message, sizeof(message));
}

static struct rpmsg_virtio_shm_pool shpool;

void app_task(void *arg1, void *arg2, void *arg3)
{
	ARG_UNUSED(arg1);
	ARG_UNUSED(arg2);
	ARG_UNUSED(arg3);
	int status = 0;
	unsigned int message = 0U;
	struct metal_device *device;
	struct metal_init_params metal_params = METAL_INIT_DEFAULTS;

	printk("\r\nOpenAMP[master] demo started\r\n");

	status = metal_init(&metal_params);
	if (status != 0) {
		printk("metal_init: failed - error code %d\n", status);
		return;
	}

	status = metal_register_generic_device(&shm_device);
	if (status != 0) {
		printk("Couldn't register shared memory device: %d\n", status);
		return;
	}

	status = metal_device_open("generic", SHM_DEVICE_NAME, &device);
	if (status != 0) {
		printk("metal_device_open failed: %d\n", status);
		return;
	}

	io = metal_device_io_region(device, 0);
	if (io == NULL) {
		printk("metal_device_io_region failed to get region\n");
		return;
	}

	/* setup IPM */
	ipm_handle = device_get_binding(DT_IPM_DEV);
	if (ipm_handle == NULL) {
		printk("device_get_binding failed to find device\n");
		return;
	}

	ipm_register_callback(ipm_handle, platform_ipm_callback, NULL);

	status = ipm_set_enabled(ipm_handle, 1);
	if (status != 0) {
		printk("ipm_set_enabled failed\n");
		return;
	}

	/* setup vdev */
	vq[0] = virtqueue_allocate(VRING_SIZE);
	if (vq[0] == NULL) {
		printk("virtqueue_allocate failed to alloc vq[0]\n");
		return;
	}
	vq[1] = virtqueue_allocate(VRING_SIZE);
	if (vq[1] == NULL) {
		printk("virtqueue_allocate failed to alloc vq[1]\n");
		return;
	}

	vdev.role = RPMSG_MASTER;
	vdev.vrings_num = VRING_COUNT;
	vdev.func = &dispatch;
	rvrings[0].io = io;
	rvrings[0].info.vaddr = (void *)VRING_TX_ADDRESS;
	rvrings[0].info.num_descs = VRING_SIZE;
	rvrings[0].info.align = VRING_ALIGNMENT;
	rvrings[0].vq = vq[0];

	rvrings[1].io = io;
	rvrings[1].info.vaddr = (void *)VRING_RX_ADDRESS;
	rvrings[1].info.num_descs = VRING_SIZE;
	rvrings[1].info.align = VRING_ALIGNMENT;
	rvrings[1].vq = vq[1];

	vdev.vrings_info = &rvrings[0];

	/* setup rvdev */
	rpmsg_virtio_init_shm_pool(&shpool, (void *)SHM_START_ADDR, SHM_SIZE);
	status = rpmsg_init_vdev(&rvdev, &vdev, ns_bind_cb, io, &shpool);
	if (status != 0) {
		printk("rpmsg_init_vdev failed %d\n", status);
		return;
	}

	/* Since we are using name service, we need to wait for a response
	 * from NS setup and than we need to process it
	 */
	k_sem_take(&data_sem, K_FOREVER);
	virtqueue_notification(vq[0]);

	/* Wait til nameservice ep is setup */
	k_sem_take(&ept_sem, K_FOREVER);

	while (message < 100) {
		status = send_message(message);
		if (status < 0) {
			printk("send_message(%d) failed with status %d\n",
			       message, status);
			goto _cleanup;
		}

		message = receive_message();
		printk("Master core received a message: %d\n", message);

		message++;
	}

_cleanup:
	rpmsg_deinit_vdev(&rvdev);
	metal_finish();

	printk("OpenAMP demo ended.\n");
}

void main(void)
{
	printk("Starting application thread!\n");
	k_thread_create(&thread_data, thread_stack, APP_TASK_STACK_SIZE,
			(k_thread_entry_t)app_task,
			NULL, NULL, NULL, K_PRIO_COOP(7), 0, 0);

#if defined(CONFIG_SOC_MPS2_AN521)
	wakeup_cpu1();
	k_sleep(500);
#endif /* #if defined(CONFIG_SOC_MPS2_AN521) */
}

/* Make sure we clear out the status flag very early (before we bringup the
 * secondary core) so the secondary core see's the proper status
 */
int init_status_flag(struct device *arg)
{
	virtio_set_status(NULL, 0);

	return 0;
}

SYS_INIT(init_status_flag, PRE_KERNEL_1, CONFIG_KERNEL_INIT_PRIORITY_DEFAULT);
```

## src/audit_s_interface_testsuite.c
```c
/*
 * Copyright (c) 2018, Arm Limited. All rights reserved.
 *
 * SPDX-License-Identifier: BSD-3-Clause
 *
 */

#include "audit_core.h"

#include "audit_wrappers.h"
#include "audit_s_tests.h"
#include "audit_tests_common.h"

/*!
 * \def BASE_RETRIEVAL_LOG_INDEX
 *
 * \brief Base index from where to start elements retrieval
 */
#define BASE_RETRIEVAL_LOG_INDEX (6)

/*!
 * \def FIRST_RETRIEVAL_LOG_INDEX
 *
 * \brief Index of the first element in the log
 */
#define FIRST_RETRIEVAL_LOG_INDEX (0)

#if 0
/* List of tests */
static void tfm_audit_test_1001(struct test_result_t *ret);

static struct test_t audit_veneers_tests[] = {
    {&tfm_audit_test_1001, "TFM_AUDIT_TEST_1001",
     "Secure functional", {0} },
};

void register_testsuite_s_audit_interface(struct test_suite_t *p_test_suite)
{
    uint32_t list_size;

    list_size = (sizeof(audit_veneers_tests) /
                 sizeof(audit_veneers_tests[0]));

    set_testsuite("Audit Logging secure interface test (TFM_AUDIT_TEST_1XXX)",
                  audit_veneers_tests, list_size, p_test_suite);
}

#endif

/**
 * \brief Functional test of the Secure interface
 *
 * \note This is a functional test only and doesn't
 *       mean to test all possible combinations of
 *       input parameters and return values.
 *       This tests will leave the log in a certain
 *       status which, in turn, will be evaluated by
 *       the Non Secure functional tests. If any tests
 *       are added here that will leave the log in a
 *       different state, Non Secure functional tests
 *       need to be amended accordingly.
 */
void tfm_audit_test_1001()
{
    enum psa_audit_err err;
    uint8_t local_buffer[LOCAL_BUFFER_SIZE], idx;
    struct psa_audit_record *record = (struct psa_audit_record *)
                                                  &local_buffer[0];
    uint32_t num_records, stored_size, record_size;
    struct psa_audit_record *retrieved_buffer;

    struct audit_core_retrieve_output retrieve_output_s;

    /* Fill the log with 36 records, each record is 28 bytes
     * we end up filling the log without wrapping
     */
    for (idx=0; idx<INITIAL_LOGGING_REQUESTS; idx++) {
        record->size = sizeof(struct psa_audit_record) - 4;
        record->id = DUMMY_TEST_RECORD_ID_BASE + idx;

        /* The record doesn't contain any payload */
        err = audit_core_add_record(record);
        if (err != PSA_AUDIT_ERR_SUCCESS) {
            printk("Record addition has returned an error\n");
            return;
        }
    }

    /* Get the log size */
    err = audit_core_get_info(&num_records, &stored_size);
    if (err != PSA_AUDIT_ERR_SUCCESS) {
        printk("Getting log info has returned error\n");
        return;
    }

    if (stored_size != INITIAL_LOGGING_SIZE) {
        printk("Expected log size is " STR(INITIAL_LOGGING_SIZE));
        return;
    }

    if (num_records != INITIAL_LOGGING_REQUESTS) {
        printk("Expected log records are " STR(INITIAL_LOGGING_REQUESTS));
        return;
    }

    /* Retrieve two log records starting from a given index */
    for (idx=BASE_RETRIEVAL_LOG_INDEX; idx<BASE_RETRIEVAL_LOG_INDEX+2; idx++) {

        struct audit_core_retrieve_input retrieve_input_s =
                                             {.record_index = idx,
                                              .buffer_size = LOCAL_BUFFER_SIZE,
                                              .token = NULL,
                                              .token_size = 0};
        retrieve_output_s.buffer =
          &local_buffer[(idx-BASE_RETRIEVAL_LOG_INDEX)*STANDARD_LOG_ENTRY_SIZE];
        retrieve_output_s.record_size = &record_size;

        err = audit_core_retrieve_record_wrapper(&retrieve_input_s,
                                               &retrieve_output_s);

        if (err != PSA_AUDIT_ERR_SUCCESS) {
            printk("Retrieve indexes 6 or 7 has returned an error\n");
            return;
        }

        if (record_size != STANDARD_LOG_ENTRY_SIZE) {
            printk("Expected log size is " STR(STANDARD_LOG_ENTRY_SIZE));
            return;
        }
    }

    /* Inspect the content of the second log record retrieved */
    retrieved_buffer = (struct psa_audit_record *)
        &local_buffer[offsetof(struct log_hdr,size)+STANDARD_LOG_ENTRY_SIZE];

    if (retrieved_buffer->id != ( DUMMY_TEST_RECORD_ID_BASE +
                                  (BASE_RETRIEVAL_LOG_INDEX+1) )) {
        printk("Unexpected argument in the index 7 entry\n");
        return;
    }

    /* Retrieve the last two log records */
    for (idx=num_records-2; idx<num_records; idx++) {

        struct audit_core_retrieve_input retrieve_input_s =
                                             {.record_index = idx,
                                              .buffer_size = LOCAL_BUFFER_SIZE,
                                              .token = NULL,
                                              .token_size = 0};
        retrieve_output_s.buffer =
            &local_buffer[(idx-(num_records-2))*STANDARD_LOG_ENTRY_SIZE];
        retrieve_output_s.record_size = &record_size;

        err = audit_core_retrieve_record_wrapper(&retrieve_input_s,
                                               &retrieve_output_s);

        if (err != PSA_AUDIT_ERR_SUCCESS) {
            printk("Retrieve of last two log records has returned error\n");
            return;
        }

        if (record_size != STANDARD_LOG_ENTRY_SIZE) {
            printk("Expected log size is " STR(STANDARD_LOG_ENTRY_SIZE));
            return;
        }
    }

    /* Inspect the first record retrieved in the local buffer */
    retrieved_buffer = (struct psa_audit_record *)
                           &local_buffer[offsetof(struct log_hdr,size)];

    if (retrieved_buffer->id != ( DUMMY_TEST_RECORD_ID_BASE +
                                  (INITIAL_LOGGING_REQUESTS-2) )) {
        printk("Unexpected argument in the second last entry\n");
        return;
    }

    /* Retrieve the first log item */
    struct audit_core_retrieve_input retrieve_input_s_first =
                                         {.record_index = 0,
                                          .buffer_size = LOCAL_BUFFER_SIZE,
                                          .token = NULL,
                                          .token_size = 0};

    retrieve_output_s.buffer = &local_buffer[0];
    retrieve_output_s.record_size = &record_size;

    err = audit_core_retrieve_record_wrapper(&retrieve_input_s_first,
                                           &retrieve_output_s);

    if (err != PSA_AUDIT_ERR_SUCCESS) {
        printk("Retrieve of the first log entry has returned error\n");
        return;
    }

    if (record_size != STANDARD_LOG_ENTRY_SIZE) {
        printk("Expected log size is " STR(STANDARD_LOG_ENTRY_SIZE));
        return;
    }

    if (retrieved_buffer->id != DUMMY_TEST_RECORD_ID_BASE) {
        printk("Unexpected argument in the first entry\n");
        return;
    }

    /* Retrieve the last log item */
    struct audit_core_retrieve_input retrieve_input_s_last =
                                         {.record_index = num_records-1,
                                          .buffer_size = LOCAL_BUFFER_SIZE,
                                          .token = NULL,
                                          .token_size = 0};

    retrieve_output_s.buffer = &local_buffer[0];
    retrieve_output_s.record_size = &record_size;

    err = audit_core_retrieve_record_wrapper(&retrieve_input_s_last,
                                           &retrieve_output_s);

    if (err != PSA_AUDIT_ERR_SUCCESS) {
        printk("Retrieve of last two log entries has returned error\n");
        return;
    }

    if (record_size != STANDARD_LOG_ENTRY_SIZE) {
        printk("Expected log size is " STR(STANDARD_LOG_ENTRY_SIZE));
        return;
    }

    /* Inspect the item just retrieved */
    if (retrieved_buffer->id != ( DUMMY_TEST_RECORD_ID_BASE +
                                  (INITIAL_LOGGING_REQUESTS-1) )) {
        printk("Unexpected argument in the second last entry\n");
        return;
    }

    /* Fill one more log record, this will wrap */
    record->size = sizeof(struct psa_audit_record) - 4;
    record->id = DUMMY_TEST_RECORD_ID_BASE + INITIAL_LOGGING_REQUESTS;

    /* The addition of this new log item will wrap the log ending */
    err = audit_core_add_record(record);
    if (err != PSA_AUDIT_ERR_SUCCESS) {
        printk("Record addition has returned an error\n");
        return;
    }

    /* Get the log size */
    err = audit_core_get_info(&num_records, &stored_size);
    if (err != PSA_AUDIT_ERR_SUCCESS) {
        printk("Getting log info has returned error\n");
        return;
    }

    /* Check that the log state is the same, the item addition just performed
     * is resulted into the removal of the oldest entry, so log size and number
     * of log records is still the same as before
     */
    if (stored_size != INITIAL_LOGGING_SIZE) {
        printk("Expected log size is " STR(INITIAL_LOGGING_SIZE));
        return;
    }

    if (num_records != INITIAL_LOGGING_REQUESTS) {
        printk("Expected log records are " STR(INITIAL_LOGGING_REQUESTS));
        return;
    }

    /* Retrieve the last two log records */
    for (idx=num_records-2; idx<num_records; idx++) {

        struct audit_core_retrieve_input retrieve_input_s =
                                             {.record_index = idx,
                                              .buffer_size = LOCAL_BUFFER_SIZE,
                                              .token = NULL,
                                              .token_size = 0};

        retrieve_output_s.buffer =
            &local_buffer[(idx-(num_records-2))*STANDARD_LOG_ENTRY_SIZE];
        retrieve_output_s.record_size = &record_size;

        /* Retrieve the last two items */
        err = audit_core_retrieve_record_wrapper(&retrieve_input_s,
                                               &retrieve_output_s);

        if (err != PSA_AUDIT_ERR_SUCCESS) {
            printk("Retrieve of last two log records has returned error\n");
            return;
        }

        if (record_size != STANDARD_LOG_ENTRY_SIZE) {
            printk("Expected record size is " STR(STANDARD_LOG_ENTRY_SIZE));
            return;
        }
    }

    /* Inspect the first record retrieved */
    if (retrieved_buffer->id != ( DUMMY_TEST_RECORD_ID_BASE +
                                  (INITIAL_LOGGING_REQUESTS-1) )) {
        printk("Unexpected argument in the second last entry\n");
        return;
    }

    /* Inspect the second record retrieved in the local buffer */
    retrieved_buffer = (struct psa_audit_record *)
        &local_buffer[offsetof(struct log_hdr,size)+STANDARD_LOG_ENTRY_SIZE];

    if (retrieved_buffer->id != ( DUMMY_TEST_RECORD_ID_BASE +
                                  (INITIAL_LOGGING_REQUESTS) )) {
        printk("Unexpected argument in the last entry\n");
        return;
    }

    /* Fill now one big record that will invalidate all existing records */
    record->size = MAX_LOG_RECORD_SIZE;
    record->id = DUMMY_TEST_RECORD_ID_BASE + INITIAL_LOGGING_REQUESTS + 1;

    /* The record has maximum possible payload for log size of 1024 */
    err = audit_core_add_record(record);
    if (err != PSA_AUDIT_ERR_SUCCESS) {
        printk("Record addition has returned an error\n");
        return;
    }

    /* Get the log size */
    err = audit_core_get_info(&num_records, &stored_size);
    if (err != PSA_AUDIT_ERR_SUCCESS) {
        printk("Getting log info has returned error\n");
        return;
    }

    /* Check that the log state has one element with maximum size */
    if (stored_size != MAX_LOG_SIZE) {
        printk("Expected log size is " STR(MAX_LOG_SIZE));
        return;
    }

    if (num_records != 1) {
        printk("Expected log records are 1\n");
        return;
    }

    /* Try to retrieve the maximum possible size that fits our buffer.
     * As there is just one big record filling the whole space, nothing
     * will be returned and the API will fail
     */
    struct audit_core_retrieve_input retrieve_input_s_max =
                                         {.record_index = 0,
                                          .buffer_size = LOCAL_BUFFER_SIZE,
                                          .token = NULL,
                                          .token_size = 0};

    retrieve_output_s.buffer = &local_buffer[0];
    retrieve_output_s.record_size = &record_size;

    err = audit_core_retrieve_record_wrapper(&retrieve_input_s_max,
                                           &retrieve_output_s);

    if (err != PSA_AUDIT_ERR_FAILURE) {
        printk("Retrieve of index 0 should fail as it's too big\n");
        return;
    }

    if (record_size != 0) {
        printk("Retrieved log size has unexpected size instead of 0\n");
        return;
    }

    /* Add two standard length records again */
    for (idx=0; idx<2; idx++) {
        record->size = sizeof(struct psa_audit_record) - 4;
        record->id = DUMMY_TEST_RECORD_ID_BASE +
                     INITIAL_LOGGING_REQUESTS + 2 + idx;

        /* The record doesn't contain any payload */
        err = audit_core_add_record(record);
        if (err != PSA_AUDIT_ERR_SUCCESS) {
            printk("Record addition has returned an error\n");
            return;
        }
    }

    /* Get the log size */
    err = audit_core_get_info(&num_records, &stored_size);
    if (err != PSA_AUDIT_ERR_SUCCESS) {
        printk("Getting log info has returned error\n");
        return;
    }

    /* As the log was full, the addition of the last two log records results
     * in the resetting of the log completely. The log will contain only
     * the last two items we have just added.
     */
    if (stored_size != FINAL_LOGGING_SIZE) {
        printk("Expected log size is " STR(FINAL_LOGGING_SIZE));
        return;
    }

    if (num_records != FINAL_LOGGING_REQUESTS) {
        printk("Expected log records are " STR(FINAL_LOGGING_REQUESTS));
        return;
    }

    /* Check the length of each record individually */
    for (idx=0; idx<num_records; idx++) {
        err = audit_core_get_record_info(idx, &stored_size);
        if (err != PSA_AUDIT_ERR_SUCCESS) {
            printk("Getting record size individually has returned error\n");
            return;
        }

        if (stored_size != STANDARD_LOG_ENTRY_SIZE) {
            printk("Unexpected log record size for a single standard item\n");
            return;
        }
    }

    /* Check that if requesting length of a record which is not there fails */
    err = audit_core_get_record_info(num_records, &stored_size);
    if (err != PSA_AUDIT_ERR_FAILURE) {
        printk("Getting record size for non-existent record has not failed\n");
        return;
    }

    printk("tfm_audit_test_1001 Pass!\n");

//    ret->val = TEST_PASSED;
}
```

## src/audit_s_tests.h
```c
/*
 * Copyright (c) 2018, Arm Limited. All rights reserved.
 *
 * SPDX-License-Identifier: BSD-3-Clause
 *
 */

#ifndef __AUDIT_S_TESTS_H__
#define __AUDIT_S_TESTS_H__

#ifdef __cplusplus
extern "C" {
#endif

//#include "test/framework/test_framework.h"

/**
 * \brief Register testsuite for audit logging secure interface.
 *
 * \param[in] p_test_suite The test suite to be executed.
 */
void register_testsuite_s_audit_interface(struct test_suite_t *p_test_suite);
void tfm_audit_test_1001(void);

#ifdef __cplusplus
}
#endif

#endif /* __AUDIT_S_TESTS_H__ */
```

## src/crypto_ns_interface_testsuite.c
```c
/*
 * Copyright (c) 2018, Arm Limited. All rights reserved.
 *
 * SPDX-License-Identifier: BSD-3-Clause
 *
 */

//#include "test/framework/test_framework_helpers.h"
#include "tfm_api.h"
#include "psa_crypto.h"
#include "tfm_crypto_defs.h"

#define BIT_SIZE_TEST_KEY (128)
#define BYTE_SIZE_TEST_KEY (BIT_SIZE_TEST_KEY/8)
#define BYTE_SIZE_CHUNK (16)
#define ENC_DEC_BUFFER_SIZE (32)
#define CIPHER_CFB_DECRYPT_LENGTH (32)
#define CIPHER_CBC_DECRYPT_LENGTH (16)
#define CIPHER_CFB_FLUSH_LENGTH (0)
#define CIPHER_CBC_FLUSH_LENGTH (16)

#if 0
/* List of tests */
static void tfm_crypto_test_6001(void);
static void tfm_crypto_test_6002(void);
static void tfm_crypto_test_6003(void);
static void tfm_crypto_test_6004(void);
static void tfm_crypto_test_6005(void);
static void tfm_crypto_test_6006(void);
static void tfm_crypto_test_6007(void);
static void tfm_crypto_test_6008(void);
static void tfm_crypto_test_6009(void);
static void tfm_crypto_test_6010(void);

static struct test_t crypto_veneers_tests[] = {
    {&tfm_crypto_test_6001, "TFM_CRYPTO_TEST_6001",
     "Non Secure Key management interface", {0} },
    {&tfm_crypto_test_6002, "TFM_CRYPTO_TEST_6002",
     "Non Secure Symmetric encryption (AES-128-CBC) interface", {0} },
    {&tfm_crypto_test_6003, "TFM_CRYPTO_TEST_6003",
     "Non Secure Symmetric encryption (AES-128-CFB) interface", {0} },
    {&tfm_crypto_test_6004, "TFM_CRYPTO_TEST_6004",
     "Non Secure Hash (SHA-1) interface", {0} },
    {&tfm_crypto_test_6005, "TFM_CRYPTO_TEST_6005",
     "Non Secure Hash (SHA-224) interface", {0} },
    {&tfm_crypto_test_6006, "TFM_CRYPTO_TEST_6006",
     "Non Secure Hash (SHA-256) interface", {0} },
    {&tfm_crypto_test_6007, "TFM_CRYPTO_TEST_6007",
     "Non Secure Hash (SHA-384) interface", {0} },
    {&tfm_crypto_test_6008, "TFM_CRYPTO_TEST_6008",
     "Non Secure Hash (SHA-512) interface", {0} },
    {&tfm_crypto_test_6009, "TFM_CRYPTO_TEST_6009",
     "Non Secure Hash (MD-5) interface", {0} },
    {&tfm_crypto_test_6010, "TFM_CRYPTO_TEST_6010",
     "Non Secure Hash (RIPEMD-160) interface", {0} },
};

void register_testsuite_ns_crypto_interface(struct test_suite_t *p_test_suite)
{
    uint32_t list_size = (sizeof(crypto_veneers_tests) /
                 sizeof(crypto_veneers_tests[0]));

    set_testsuite("Crypto non-secure interface test (TFM_CRYPTO_TEST_6XXX)",
                  crypto_veneers_tests, list_size, p_test_suite);
}
#endif 
/**
 * \brief Non-secure interface test for Crypto
 *
 * \details The scope of this set of tests is to functionally verify
 *          the interfaces specified by psa_crypto.h are working
 *          as expected. This is not meant to cover all possible
 *          scenarios and corner cases.
 *
 */
void tfm_crypto_test_6001(void)
{
    psa_status_t status = PSA_SUCCESS;
    uint32_t i = 0;
    const psa_key_slot_t slot = 0;
    const uint8_t data[] = "THIS IS MY KEY1";
    psa_key_type_t type = PSA_KEY_TYPE_NONE;
    size_t bits = 0;
    uint8_t exported_data[sizeof(data)] = {0};
    size_t exported_data_size = 0;

    status = tfm_crypto_import_key(slot, PSA_KEY_TYPE_AES, data, sizeof(data));
    if (status != PSA_SUCCESS) {
        printk("Error importing a key %d\n", status);
        return;
    }

    status = tfm_crypto_get_key_information(slot, &type, &bits);
    if (status != PSA_SUCCESS) {
        printk("Error getting key metadata\n");
        return;
    }

    if (bits != BIT_SIZE_TEST_KEY) {
        printk("The number of key bits is different from expected\n");
        return;
    }

    if (type != PSA_KEY_TYPE_AES) {
        printk("The type of the key is different from expected\n");
        return;
    }

    status = tfm_crypto_export_key(slot,
                            exported_data,
                            sizeof(data),
                            &exported_data_size);

    if (status != PSA_SUCCESS) {
        printk("Error exporting a key\n");
        return;
    }

    if (exported_data_size != BYTE_SIZE_TEST_KEY) {
        printk("Number of bytes of exported key different from expected\n");
        return;
    }

    /* Check that the exported key is the same as the imported one */
    for (i=0; i<exported_data_size; i++) {
        if (exported_data[i] != data[i]) {
            printk("Exported key doesn't match the imported key\n");
            return;
        }
    }

    status = tfm_crypto_destroy_key(slot);
    if (status != PSA_SUCCESS) {
        printk("Error destroying the key\n");
        return;
    }

    status = tfm_crypto_get_key_information(slot, &type, &bits);
    if (status != TFM_CRYPTO_ERR_PSA_ERROR_EMPTY_SLOT) {
        printk("Key slot should be empty now\n");
        return;
    }

    printk("Test %s Pass!\n", __func__);
//    ret->val = TEST_PASSED;
}

static uint32_t compare_buffers(const uint8_t *p1,
                                const uint8_t *p2,
                                uint32_t s1,
                                uint32_t s2)
{
    uint32_t i = 0, comp_size = (s1 < s2) ? s1 : s2;

    for (i=0; i<comp_size; i++) {
        if (p1[i] != p2[i]) {
            return 1;
        }
    }

    return 0;
}

void psa_cipher_test(const psa_algorithm_t alg)
{
    psa_cipher_operation_t handle, handle_dec;
    psa_status_t status = PSA_SUCCESS;
    const psa_key_slot_t slot = 0;
    const uint8_t data[] = "THIS IS MY KEY1";
    psa_key_type_t type = PSA_KEY_TYPE_NONE;
    size_t bits = 0;
    const size_t iv_length = 16;
    const uint8_t iv[] = "012345678901234";
    const uint8_t plain_text[BYTE_SIZE_CHUNK] = "Sixteen bytes!!";
    uint8_t decrypted_data[ENC_DEC_BUFFER_SIZE] = {0};
    size_t output_length = 0, expected_output_length = 0;
    uint8_t encrypted_data[ENC_DEC_BUFFER_SIZE] = {0};
    uint32_t comp_result;

    /* Import a key on slot 0 */
    status = tfm_crypto_import_key(slot, PSA_KEY_TYPE_AES, data, sizeof(data));
    if (status != PSA_SUCCESS) {
        printk("Error importing a key %d\n", status);
        return;
    }

    status = tfm_crypto_get_key_information(slot, &type, &bits);
    if (status != PSA_SUCCESS) {
        printk("Error getting key metadata\n");
        return;
    }

    if (bits != BIT_SIZE_TEST_KEY) {
        printk("The number of key bits is different from expected\n");
        return;
    }

    if (type != PSA_KEY_TYPE_AES) {
        printk("The type of the key is different from expected\n");
        return;
    }

    /* Setup the encryption object */
    status = tfm_crypto_encrypt_setup(&handle, slot, alg);
    if (status != PSA_SUCCESS) {
        printk("Error setting up cipher operation object %d\n", status);
        return;
    }

    /* Set the IV */
    status = tfm_crypto_encrypt_set_iv(&handle, iv, iv_length);
    if (status != PSA_SUCCESS) {
        printk("Error setting the IV on the cypher operation object\n");
        return;
    }

    /* Encrypt one chunk of information */
    status = tfm_crypto_cipher_update(&handle, plain_text, BYTE_SIZE_CHUNK,
                               encrypted_data, ENC_DEC_BUFFER_SIZE,
                               &output_length);

    if (status != PSA_SUCCESS) {
        printk("Error encrypting one chunk of information\n");
        return;
    }

    if (output_length != BYTE_SIZE_CHUNK) {
        printk("Expected encrypted data length is different from expected\n");
        return;
    }

    /* Finalise the cipher operation */
    status = tfm_crypto_cipher_finish(&handle, &encrypted_data[output_length],
                               ENC_DEC_BUFFER_SIZE - output_length,
                               &output_length);

    if (status != PSA_SUCCESS) {
        printk("Error finalising the cipher operation\n");
        return;
    }

    if (output_length != 0) {
        printk("Unexpected output length after finalisation\n");
        return;
    }

    /* Setup the decryption object */
    if (alg == PSA_ALG_CFB_BASE) {
        /* In CFB mode the object is always in encryption mode */
        status = tfm_crypto_encrypt_setup(&handle_dec, slot, alg);
    } else {
        status = tfm_crypto_decrypt_setup(&handle_dec, slot, alg);
    }

    if (status != PSA_SUCCESS) {
        printk("Error setting up cipher operation object\n");
        return;
    }

    /* Set the IV for decryption */
    if (alg == PSA_ALG_CFB_BASE) {
        /*  In CFB mode the object is in encryption mode, so follow the
         *  encryption flow.
         */
        status = tfm_crypto_encrypt_set_iv(&handle_dec, iv, iv_length);
    } else {
        status = tfm_crypto_cipher_update(&handle_dec, iv, iv_length,
                                   encrypted_data, ENC_DEC_BUFFER_SIZE,
                                   &output_length);
    }

    if (status != PSA_SUCCESS) {
        printk("Error setting the IV for decryption\n");
        return;
    }

    if (alg != PSA_ALG_CFB_BASE) {
        if (output_length != 0) {
            printk("Expected output length is different from expected\n");
            return;
        }
    }

    /* Decrypt */
    status = tfm_crypto_cipher_update(&handle_dec, encrypted_data, ENC_DEC_BUFFER_SIZE,
                               decrypted_data, BYTE_SIZE_CHUNK, &output_length);

    if (status != PSA_SUCCESS) {
        printk("Error during decryption\n");
        return;
    }

    if (alg == PSA_ALG_CFB_BASE) {
        expected_output_length = CIPHER_CFB_DECRYPT_LENGTH;
    } else {
        expected_output_length = CIPHER_CBC_DECRYPT_LENGTH;
    }

    if (output_length != expected_output_length) {
        printk("Decrypted length is different from expected one\n");
        return;
    }

    /* Check that the plain text matches the decrypted data */
    comp_result = compare_buffers(plain_text, decrypted_data,
                                  sizeof(plain_text), sizeof(decrypted_data));
    if (comp_result != 0) {
        printk("Decrypted data doesn't match with plain text\n");
        return;
    }

    /* Finalise the cipher operation for decryption (destroys decrypted data) */
    status = tfm_crypto_cipher_finish(&handle_dec, decrypted_data, BYTE_SIZE_CHUNK,
                               &output_length);

    if (status != PSA_SUCCESS) {
        printk("Error finalising the cipher operation\n");
        return;
    }

    if (alg == PSA_ALG_CFB_BASE) {
        expected_output_length = CIPHER_CFB_FLUSH_LENGTH;
    } else {
        expected_output_length = CIPHER_CBC_FLUSH_LENGTH;
    }

    if (output_length != expected_output_length) {
        printk("After finalising, unexpected decrypted length\n");
        return;
    }

    /* Destroy the key on slot 0 */
    status = tfm_crypto_destroy_key(slot);
    if (status != PSA_SUCCESS) {
        printk("Error destroying a key\n");
        return;
    }

//    ret->val = TEST_PASSED;
}

void tfm_crypto_test_6002(void)
{
    printk("Start Test %s!\n", __func__);
    psa_cipher_test(PSA_ALG_CBC_BASE);
}

void tfm_crypto_test_6003(void)
{
    printk("Start Test %s!\n", __func__);
    psa_cipher_test(PSA_ALG_CFB_BASE);
}

/*
 * \brief This is the list of algorithms supported by the current
 *        configuration of the crypto engine used by the crypto
 *        service. In case the crypto engine default capabilities
 *        is changed, this list needs to be updated accordingly
 */
static const psa_algorithm_t hash_alg[] = {
    PSA_ALG_SHA_1,
    PSA_ALG_SHA_224,
    PSA_ALG_SHA_256,
    PSA_ALG_SHA_384,
    PSA_ALG_SHA_512,
    PSA_ALG_MD5,
    PSA_ALG_RIPEMD160
};

static const uint8_t hash_val[][PSA_HASH_SIZE(PSA_ALG_SHA_512)] = {
    {0x56, 0x4A, 0x0E, 0x35, 0xF1, 0xC7, 0xBC, 0xD0, /*!< SHA-1 */
     0x7D, 0xCF, 0xB1, 0xBC, 0xC9, 0x16, 0xFA, 0x2E,
     0xF5, 0xBE, 0x96, 0xB2},
    {0x00, 0xD2, 0x90, 0xE2, 0x0E, 0x4E, 0xC1, 0x7E, /*!< SHA-224 */
     0x7A, 0x95, 0xF5, 0x10, 0x5C, 0x76, 0x74, 0x04,
     0x6E, 0xB5, 0x56, 0x5E, 0xE5, 0xE7, 0xBA, 0x15,
     0x6C, 0x23, 0x47, 0xF3},
    {0x6B, 0x22, 0x09, 0x2A, 0x37, 0x1E, 0xF5, 0x14, /*!< SHA-256 */
     0xF7, 0x39, 0x4D, 0xCF, 0xAD, 0x4D, 0x17, 0x46,
     0x66, 0xCB, 0x33, 0xA0, 0x39, 0xD8, 0x41, 0x4E,
     0xF1, 0x2A, 0xD3, 0x4D, 0x69, 0xC3, 0xB5, 0x3E},
    {0x64, 0x79, 0x11, 0xBB, 0x47, 0x4E, 0x47, 0x59, /*!< SHA-384 */
     0x3E, 0x4D, 0xBC, 0x60, 0xA5, 0xF9, 0xBF, 0x9C,
     0xC0, 0xBA, 0x55, 0x0F, 0x93, 0xCA, 0x72, 0xDF,
     0x57, 0x1E, 0x50, 0x56, 0xF9, 0x4A, 0x01, 0xD6,
     0xA5, 0x6F, 0xF7, 0x62, 0x34, 0x4F, 0x48, 0xFD,
     0x9D, 0x15, 0x07, 0x42, 0xB7, 0x72, 0x94, 0xB8},
    {0xB4, 0x1C, 0xA3, 0x6C, 0xA9, 0x67, 0x1D, 0xAD, /*!< SHA-512 */
     0x34, 0x1F, 0xBE, 0x1B, 0x83, 0xC4, 0x40, 0x2A,
     0x47, 0x42, 0x79, 0xBB, 0x21, 0xCA, 0xF0, 0x60,
     0xE4, 0xD2, 0x6E, 0x9B, 0x70, 0x12, 0x34, 0x3F,
     0x55, 0x2C, 0x09, 0x31, 0x0A, 0x5B, 0x40, 0x21,
     0x01, 0xA8, 0x3B, 0x58, 0xE7, 0x48, 0x13, 0x1A,
     0x7E, 0xCD, 0xE1, 0xD2, 0x46, 0x10, 0x58, 0x34,
     0x49, 0x14, 0x4B, 0xAA, 0x89, 0xA9, 0xF5, 0xB1},
    {0x63, 0xFC, 0x11, 0x88, 0xB7, 0x03, 0xDD, 0xD5, /*!< MD-5 */
     0x36, 0xB9, 0x2F, 0xD6, 0x9E, 0x91, 0x96, 0xF8},
    {0xF5, 0x8E, 0xB3, 0xCB, 0xE5, 0xF0, 0x3B, 0xC5, /*!< RIPEMD-160 */
     0x7C, 0x45, 0xE2, 0x49, 0xAA, 0x66, 0xC6, 0x5A,
     0x47, 0xEA, 0x34, 0x91},
    {0x7E, 0x28, 0x13, 0xAE, 0x98, 0xBD, 0x38, 0x6C, /*!< MD-2 */
     0xDC, 0x8C, 0xF8, 0x04, 0xC6, 0x58, 0xA9, 0x69},
    {0xA0, 0xB9, 0x82, 0x4E, 0xE0, 0x74, 0x4F, 0x1E, /*!< MD-4 */
     0xA4, 0x7F, 0xA3, 0xDF, 0xD0, 0x0D, 0x97, 0xEB},
};

void psa_hash_test(const psa_algorithm_t alg)
{
    const char *msg[] = {"This is my test message, ",
                         "please generate a hash for this."};

    const size_t msg_size[] = {25, 32}; /* Length in bytes of msg[0], msg[1] */
    const uint32_t msg_num = sizeof(msg)/sizeof(msg[0]);
    uint32_t idx;

    psa_status_t status;
    psa_hash_operation_t handle;

    /* Setup the hash object for the desired hash*/
    status = tfm_crypto_hash_start(&handle, alg);

    if (status != PSA_SUCCESS) {
        if (status == TFM_CRYPTO_ERR_PSA_ERROR_NOT_SUPPORTED) {
            printk("Algorithm NOT SUPPORTED by the implementation\n");
            return;
        }

        printk("Error setting up hash operation object %d\n", status);
        return;
    }

    /* Update object with all the chunks of message */
    for (idx=0; idx<msg_num; idx++) {
        status = tfm_crypto_hash_update(&handle,
                                 (const uint8_t *)msg[idx],msg_size[idx]);
        if (status != PSA_SUCCESS) {
            printk("Error updating the hash operation object\n");
            return;
        }
    }

    /* Cycle until idx points to the correct index in the algorithm table */
    for (idx=0; hash_alg[idx] != alg; idx++);

    /* Finalise and verify that the hash is as expected */
    status = tfm_crypto_hash_verify(&handle, &(hash_val[idx][0]), PSA_HASH_SIZE(alg));
    if (status != PSA_SUCCESS) {
        printk("Error verifying the hash operation object\n");
        return;
    }

//    ret->val = TEST_PASSED;
}

void tfm_crypto_test_6004(void)
{
    printk("Start Test %s!\n", __func__);
    psa_hash_test(PSA_ALG_SHA_1);
}

void tfm_crypto_test_6005(void)
{
    printk("Start Test %s!\n", __func__);
    psa_hash_test(PSA_ALG_SHA_224);
}

void tfm_crypto_test_6006(void)
{
    printk("Start Test %s!\n", __func__);
    psa_hash_test(PSA_ALG_SHA_256);
}

void tfm_crypto_test_6007(void)
{
    printk("Start Test %s!\n", __func__);
    psa_hash_test(PSA_ALG_SHA_384);
}

void tfm_crypto_test_6008(void)
{
    printk("Start Test %s!\n", __func__);
    psa_hash_test(PSA_ALG_SHA_512);
}

void tfm_crypto_test_6009(void)
{
    printk("Start Test %s!\n", __func__);
    psa_hash_test(PSA_ALG_MD5);
}

void tfm_crypto_test_6010(void)
{
    printk("Start Test %s!\n", __func__);
    psa_hash_test(PSA_ALG_RIPEMD160);
}
```

## src/crypto_s_tests.h
```c
/*
 * Copyright (c) 2018, Arm Limited. All rights reserved.
 *
 * SPDX-License-Identifier: BSD-3-Clause
 *
 */

#ifndef __CRYPTO_S_TESTS_H__
#define __CRYPTO_S_TESTS_H__

#ifdef __cplusplus
extern "C" {
#endif

//#include "test/framework/test_framework.h"

void register_testsuite_s_crypto_interface(struct test_suite_t *p_test_suite);
void tfm_crypto_test_5001(void);
void tfm_crypto_test_6001(void);
void tfm_crypto_test_6002(void);
void tfm_crypto_test_6003(void);
void tfm_crypto_test_6004(void);
void tfm_crypto_test_6005(void);
void tfm_crypto_test_6006(void);
void tfm_crypto_test_6007(void);
void tfm_crypto_test_6008(void);
void tfm_crypto_test_6009(void);
void tfm_crypto_test_6010(void);

#endif /* __CRYPTO_S_TESTS_H__ */
```

## src/crypto_sec_interface_testsuite.c
```c
/*
 * Copyright (c) 2018, Arm Limited. All rights reserved.
 *
 * SPDX-License-Identifier: BSD-3-Clause
 *
 */

#include <stdio.h>

//#include "test/framework/test_framework_helpers.h"
#include "tfm_crypto_veneers.h"

#define BIT_SIZE_TEST_KEY (128)
#define BYTE_SIZE_TEST_KEY (BIT_SIZE_TEST_KEY/8)

#if 0
/* List of tests */
static void tfm_crypto_test_5001(struct test_result_t *ret);

static struct test_t crypto_tests[] = {
    {&tfm_crypto_test_5001, "TFM_CRYPTO_TEST_5001",
     "Secure Key management interface", {0}},
};

void register_testsuite_s_crypto_interface(struct test_suite_t *p_test_suite)
{
    uint32_t list_size = (sizeof(crypto_tests) / sizeof(crypto_tests[0]));

    set_testsuite("Crypto secure interface tests (TFM_CRYPTO_TEST_5XXX)",
                  crypto_tests, list_size, p_test_suite);
}

#endif
/**
 * \brief Secure interface test for Crypto
 *
 * \details The scope of this test is to perform a basic validation of
 *          the secure interface for the Key management module.
 */
void tfm_crypto_test_5001(struct test_result_t *ret)
{
    enum tfm_crypto_err_t err;
    uint32_t i = 0;
    const psa_key_slot_t slot = 0;
    const uint8_t data[] = "THIS IS MY KEY1";
    psa_key_type_t type = PSA_KEY_TYPE_NONE;
    size_t bits = 0;
    uint8_t exported_data[sizeof(data)] = {0};
    size_t exported_data_size = 0;

    err = tfm_crypto_import_key(slot,
                                       PSA_KEY_TYPE_AES,
                                       data,
                                       sizeof(data));

    if (err != TFM_CRYPTO_ERR_PSA_SUCCESS) {
        printk("Error importing a key\n");
        return;
    }

    err = tfm_crypto_get_key_information(slot, &type, &bits);
    if (err != TFM_CRYPTO_ERR_PSA_SUCCESS) {
        printk("Error getting key metadata\n");
        return;
    }

    if (bits != BIT_SIZE_TEST_KEY) {
        printk("The number of key bits is different from expected\n");
        return;
    }

    if (type != PSA_KEY_TYPE_AES) {
        printk("The type of the key is different from expected\n");
        return;
    }

    err = tfm_crypto_export_key(slot,
                                       exported_data,
                                       sizeof(data),
                                       &exported_data_size);

    if (err != TFM_CRYPTO_ERR_PSA_SUCCESS) {
        printk("Error exporting a key\n");
        return;
    }

    if (exported_data_size != BYTE_SIZE_TEST_KEY) {
        printk("Number of bytes of exported key different from expected\n");
        return;
    }

    /* Check that the exported key is the same as the imported one */
    for (i=0; i<exported_data_size; i++) {
        if (exported_data[i] != data[i]) {
            printk("Exported key doesn't match the imported key\n");
            return;
        }
    }

    err = tfm_crypto_destroy_key(slot);
    if (err != TFM_CRYPTO_ERR_PSA_SUCCESS) {
        printk("Error destroying the key\n");
        return;
    }

    err = tfm_crypto_get_key_information(slot, &type, &bits);
    if (err != TFM_CRYPTO_ERR_PSA_ERROR_EMPTY_SLOT) {
        printk("Key slot should be empty now\n");
        return;
    }

     printk("tfm_crypto_test_5001 Pass!\n");
//    ret->val = TEST_PASSED;
}
```
