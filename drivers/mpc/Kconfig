## drivers/mpc/Kconfig
```kconfig
menuconfig MPC
	bool "arm MPC drivers"
	help
	  Include interrupt-based inter-processor Message Handling Unit
	  drivers in system configuration

if MHU

config MHU0
	bool "MHU0 driver"
	depends on MHU
	help
	  Enable Driver for MHU0

config MHU1
	bool "MHU1 driver"
	depends on MHU
	help
	  Enable Driver for MHU1

endif # MHU
```

## dts/bindings/mhu/arm,mhu.yaml
```yaml
---
title: ARM MHU
version: 0.1

description: >
    This binding gives a base representation of the ARM MHU

properties:
    compatible:
      type: string
      category: required
      description: compatible strings
      constraint: "arm,mhu"
      generation: define

    reg:
      type: array
      description: mmio register space
      generation: define
      category: required

    interrupts:
      type: array
      category: required
      description: required interrupts
      generation: define
...
```

## samples/tfm_integration/sample.yaml
```yaml
sample:
  description: TF-M Integration sample
    application
  name: TF-M Integration
    tags: introduction
    harness: console
tests:
  sample.helloworld:
    tags: introduction
```

## samples/tfm_integration/tfm_psa_arch_tests/sample.yaml
```yaml
sample:
  description: TF-M psa-arch-tests sample
    application
  name: TF-M PSA ARCH TESTS
tests:
  sample.tfm_ipc:
    tags: introduction
    platform_whitelist: mps2_an521_nonsecure v2m_musca_b1_nonsecure
```
